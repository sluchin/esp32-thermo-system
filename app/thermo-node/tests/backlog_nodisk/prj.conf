## CMakeLists.txt
```
# thermo-node の backlog.c の単体テスト: SD カードがない (マウントできない) とき.
# マウントポイントを存在しないディスクの名前 (/NODISK:. RAM ディスクの名前は RAM) にしてマウントの失敗を作る.
cmake_minimum_required(VERSION 3.20.0)

find_package(Zephyr REQUIRED HINTS $ENV{ZEPHYR_BASE})
project(thermo_node_backlog_nodisk_test)

target_include_directories(app PRIVATE ${CMAKE_CURRENT_LIST_DIR}/../../src
                           ${CMAKE_CURRENT_LIST_DIR}/../../../common)
target_compile_definitions(app PRIVATE CONFIG_THERMO_BACKLOG=1 CONFIG_THERMO_BACKLOG_MOUNT="/NODISK:"
                           CONFIG_THERMO_BACKLOG_MAX_RECORDS=5)
target_sources(app PRIVATE
  src/test_backlog_nodisk.c
  ${CMAKE_CURRENT_LIST_DIR}/../../src/backlog.c
)

# 警告オプション (app/warnings.txt). 警告が出たら修正する
include(${CMAKE_CURRENT_LIST_DIR}/../../../warnings.cmake)
```

## prj.conf
```kconfig
# Ztest
CONFIG_ZTEST=y
CONFIG_LOG=y
# FatFS (RAM ディスクはあるが, 名前が合わないマウントポイントでマウントに失敗させる)
CONFIG_DISK_ACCESS=y
CONFIG_DISK_DRIVER_RAM=y
CONFIG_FS_FATFS_MKFS=y
CONFIG_FILE_SYSTEM=y
CONFIG_FAT_FILESYSTEM_ELM=y
CONFIG_CRC=y
```

## app.overlay
```dts
/ {
    ramdisk0 {
        compatible = "zephyr,ram-disk";
        disk-name = "RAM";
        sector-size = <512>;
        sector-count = <256>;
    };
};
```

## src/test_backlog_nodisk.c
```c
/*
 * Copyright (c) 2026 Tetsuya Higashi
 *
 * SPDX-License-Identifier: GPL-3.0-or-later
 */

/**
 * @file
 * @brief backlog.c の単体テスト (SD カードがないとき)
 *
 * ディスクがなく, マウントできないとき, 次のようになることを確認する.
 *  - backlog_init() が -ENODEV を返すこと
 *  - 追記, 読み出し, 送り終えたことの記録, 時刻以降の記録の読み出しが使えないこと
 * (保存した記録は 0 件)
 */

#include <zephyr/ztest.h>
#include <errno.h>  /* ENODEV EINVAL */
#include <stdlib.h> /* EXIT_SUCCESS */

#include "backlog.h"

/**
 * backlog_foreach_since() に渡す関数 (何もしない)
 *
 * @param[in] rec 使用しない
 * @param[in] ctx 使用しない
 */
static void ignore(const struct backlog_record *rec, void *ctx)
{
    ARG_UNUSED(rec);
    ARG_UNUSED(ctx);
}

/** マウントできないので, -ENODEV. 記録は 0 件 */
ZTEST(backlog_nodisk, test_init_fails_without_the_disk)
{
    zassert_equal(backlog_init(), -ENODEV);
    zassert_equal(backlog_pending(), 0U);
}

/** マウントしていないので, 追記は -ENODEV, 読み出しは範囲の外 (-EINVAL), 数 0 の確定は何もしない */
ZTEST(backlog_nodisk, test_nothing_works_without_the_disk)
{
    struct backlog_record rec = {.unix_s = 1790000000LL, .temp_x10 = 235, .humidity_x10 = 450U};

    zassert_equal(backlog_init(), -ENODEV);
    zassert_equal(backlog_append(&rec, false), -ENODEV);
    zassert_equal(backlog_read(&rec, 0U), -EINVAL);
    zassert_equal(backlog_commit(0U), EXIT_SUCCESS);
    zassert_equal(backlog_commit(1U), -EINVAL);
    zassert_equal(backlog_foreach_since(0, ignore, NULL), -ENODEV);
}

ZTEST_SUITE(backlog_nodisk, NULL, NULL, NULL, NULL, NULL);
```
