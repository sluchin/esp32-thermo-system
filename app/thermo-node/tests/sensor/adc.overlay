/* ADC エミュレータ (adc0) の, チャンネル 0 を, zephyr,user の io-channels に接続する */
#include <zephyr/dt-bindings/adc/adc.h>

/ {
    zephyr,user {
        io-channels = <&adc0 0>;
    };
};

&adc0 {
    status = "okay";
    ref-internal-mv = <3300>;
    #address-cells = <1>;
    #size-cells = <0>;

    channel@0 {
        reg = <0>;
        zephyr,gain = "ADC_GAIN_1";
        zephyr,reference = "ADC_REF_INTERNAL";
        zephyr,acquisition-time = <ADC_ACQ_TIME_DEFAULT>;
        zephyr,resolution = <12>;
    };
};
