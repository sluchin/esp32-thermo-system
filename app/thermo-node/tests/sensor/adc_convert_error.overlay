/*
 * adc.overlay と同じ ADC を, io-channels に接続するが, チャンネルのノード (channel@0) がない.
 * sensor_init() は失敗するが, 読み取りはできて, 電圧への換算 (adc_raw_to_millivolts_dt) が,
 * -ENOTSUP で失敗する
 */
/ {
	zephyr,user {
		io-channels = <&adc0 0>;
	};
};

&adc0 {
	status = "okay";
	ref-internal-mv = <3300>;
};
