/*
 * adc.overlay と同じ構成で, エミュレータが対応していない基準電圧 (ADC_REF_VDD_1. ref-vdd-1-mv が未設定)
 * を指定する. adc_channel_setup_dt() を失敗させる
 */
#include <zephyr/dt-bindings/adc/adc.h>

/ {
	zephyr,user {
		io-channels = <&adc0 0>;
	};
};

&adc0 {
	status = "okay";
	ref-internal-mv = <3300>;
	#address-cells = <1>;
	#size-cells = <0>;

	channel@0 {
		reg = <0>;
		zephyr,gain = "ADC_GAIN_1";
		zephyr,reference = "ADC_REF_VDD_1";
		zephyr,acquisition-time = <ADC_ACQ_TIME_DEFAULT>;
		zephyr,resolution = <12>;
	};
};
