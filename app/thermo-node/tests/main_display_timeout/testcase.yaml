## app/thermo-node/tests/sensor/dts/bindings/vnd,test-sensor.yaml
```yaml
# thermo-node の単体テスト用の, 偽のセンサ (値と, エラーはテストから設定する)
description: Fake sensor for the unit test of thermo-node

compatible: "vnd,test-sensor"

include: base.yaml
```

## west.yml
```yaml
manifest:
  version: "0.13"

  remotes:
    - name: zephyrproject-rtos
      url-base: https://github.com/zephyrproject-rtos

  projects:
    - name: zephyr
      remote: zephyrproject-rtos
      revision: v4.3.0
      import: true
      path: zephyr

  self:
    path: esp32-thermo-system
```
