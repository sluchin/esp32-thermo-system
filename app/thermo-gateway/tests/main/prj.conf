## CMakeLists.txt
```
# thermo-gateway の main.c の単体テスト (Ztest + FFF).
# ble と cloud の関数 (ble_init(), cloud_init() など) を FFF のモックに置き換える.
# main.c の main() は Zephyr のテストの main() と名前が同じなので名前を変える.
cmake_minimum_required(VERSION 3.20.0)

find_package(Zephyr REQUIRED HINTS $ENV{ZEPHYR_BASE})
project(thermo_gateway_main_test)

target_include_directories(app PRIVATE ${CMAKE_CURRENT_LIST_DIR}/../../src
                           ${CMAKE_CURRENT_LIST_DIR}/../../../common)
# AWS IoT Core への送信 (cloud の関数は FFF のモック). CONFIG_THERMO_CLOUD はアプリの Kconfig が
# 定義するが, このテストはアプリの Kconfig を使わないので, ここで定義する.
target_compile_definitions(app PRIVATE CONFIG_THERMO_CLOUD=1)
target_sources(app PRIVATE
  src/test_main.c
  ${CMAKE_CURRENT_LIST_DIR}/../../src/main.c)
# 名前を変えた main() はヘッダに宣言がないので, その警告は出さない
set_source_files_properties(${CMAKE_CURRENT_LIST_DIR}/../../src/main.c PROPERTIES
  COMPILE_DEFINITIONS main=thermo_gateway_main
  COMPILE_OPTIONS "-Wno-missing-prototypes;-Wno-missing-declarations")

# 警告オプション (app/warnings.txt). 警告が出たら修正する
include(${CMAKE_CURRENT_LIST_DIR}/../../../warnings.cmake)
# モック (FFF の FAKE_VALUE_FUNC) はヘッダにある関数を同じ型で再宣言する
target_compile_options(app PRIVATE -Wno-redundant-decls)
```

## prj.conf
```kconfig
# Ztest
CONFIG_ZTEST=y
CONFIG_LOG=y
# メインループの待ち時間 (10 秒) を実時間で待たない
CONFIG_NATIVE_SIM_SLOWDOWN_TO_REAL_TIME=n
```

## src/test_main.c
```c
/*
 * Copyright (c) 2026 Tetsuya Higashi
 *
 * SPDX-License-Identifier: GPL-3.0-or-later
 */

/**
 * @file
 * @brief main.c の単体テスト
 *
 * ble の関数を FFF のモックに置き換えて, 次を確認する.
 *  - 初期化に失敗したら, 後の処理に進まず, EXIT_FAILURE を返すこと
 *  - 初期化に成功したら, 終了せずに稼働状況の出力を続けること (別スレッドで main を動かす)
 */

#include <zephyr/ztest.h>
#include <zephyr/fff.h>
#include <zephyr/kernel.h>
#include <errno.h>  /* EIO EALREADY ENOMSG EBUSY */
#include <stdint.h> /* uint32_t uint16_t uintptr_t int16_t */
#include <stdlib.h> /* EXIT_FAILURE */
#include <string.h> /* memset */

#include "ble.h"
#include "cloud.h"
#include "ntp.h"
#include "switchbot.h"
#include "thermo_ble_uuid.h"

DEFINE_FFF_GLOBALS

/**
 * main.c の main() (CMakeLists.txt で名前を変えている)
 *
 * @return main.c の main() の戻り値
 */
int thermo_gateway_main(void);

/* FAKE_*: FFF のモック (実物の代わりの関数. 呼ばれた回数と引数を記録する) */
FAKE_VALUE_FUNC(int, ble_init)
FAKE_VALUE_FUNC(int, ble_scan)
FAKE_VOID_FUNC(ble_set_temperature_callback, ble_temperature_cb_t)
FAKE_VOID_FUNC(ble_set_switchbot_callback, ble_switchbot_cb_t)
FAKE_VOID_FUNC(ble_set_time_source, ble_time_source_t)
FAKE_VALUE_FUNC(int, ntp_unix_time, int64_t *)
FAKE_VALUE_FUNC(bool, switchbot_accept, const bt_addr_le_t *, const struct switchbot_ad *, uint32_t,
                struct switchbot_sample *)
FAKE_VALUE_FUNC(int, cloud_publish_switchbot, const bt_addr_le_t *, const struct switchbot_sample *)
FAKE_VALUE_FUNC(int, cloud_init, bool)
FAKE_VALUE_FUNC(int, cloud_publish_temperature, const bt_addr_le_t *, int16_t, uint16_t, uint16_t)

/** メインループのスレッドのスタックサイズ */
#define STACK_SIZE        2048
/** メインループのスレッドの優先度 */
#define THREAD_PRIORITY   5
/** main.c の稼働状況の出力間隔 [秒] (STATUS_INTERVAL_S) */
#define STATUS_INTERVAL_S 10
/** 起動直後を待つ時間 [ms] */
#define STARTUP_WAIT_MS   100
/** 何周期ぶん待つか */
#define WAIT_CYCLES       3

/**
 * 関数のアドレス (fff.call_history の要素と比べる)
 * (関数ポインタをオブジェクトポインタへ直接キャストすることは ISO C では許されない)
 */
#define FUNCTION_ADDRESS(f) ((void *)(uintptr_t)(f))

/** 温度のコールバックに渡す, ノードのアドレス */
static const bt_addr_le_t test_addr = {
    .type = BT_ADDR_LE_RANDOM,
    .a = {.val = {0x01, 0x02, 0x03, 0x04, 0x05, 0x06}},
};
/** 温度のコールバックに渡す温度 [℃ の 10 倍] (-3.5 ℃. 負の温度の出力を通す) */
#define TEST_TEMP_X10     (-35)
/** 温度のコールバックに渡す湿度 [% の 10 倍] (45.0 %) */
#define TEST_HUMIDITY_X10 450U
/** テストの気圧 [hPa の 10 倍] (1013.2 hPa) */
#define TEST_PRESSURE_X10 10132U

/** main を動かすスレッド */
static struct k_thread main_thread;
/** main を動かすスレッドのスタック */
static K_THREAD_STACK_DEFINE(main_stack, STACK_SIZE)

/**
 * main を動かすスレッドの入口
 *
 * @param[in] p1 使用しない
 * @param[in] p2 使用しない
 * @param[in] p3 使用しない
 */
static void main_entry(void *p1, void *p2, void *p3)
{
    ARG_UNUSED(p1);
    ARG_UNUSED(p2);
    ARG_UNUSED(p3);
    (void)thermo_gateway_main();
}

/** switchbot_accept() が送信する値として返す温度 [℃ の 10 倍] (テストが変える) */
static int16_t accepted_temp_x10 = 235;
/** cloud_publish_switchbot() に渡された値の写し (引数は呼び出しの後は無効になる) */
static struct switchbot_sample published_sample;

/**
 * switchbot_accept() のモック動作 (送信する値を返す. 戻り値は return_val で決める)
 *
 * @param[in] addr 使用しない
 * @param[in] ad 使用しない
 * @param[in] now_ms 使用しない
 * @param[out] out 送信する値
 * @return switchbot_accept_fake.return_val
 */
static bool fake_accept(const bt_addr_le_t *addr, const struct switchbot_ad *ad, uint32_t now_ms,
                        struct switchbot_sample *out)
{
    ARG_UNUSED(addr);
    ARG_UNUSED(ad);
    ARG_UNUSED(now_ms);
    out->temp_x10 = accepted_temp_x10;
    out->humidity = 55U;
    out->battery = 87;

    return switchbot_accept_fake.return_val;
}

/**
 * cloud_publish_switchbot() のモック動作 (渡された値を写す)
 *
 * @param[in] addr 使用しない
 * @param[in] sample 送信する値
 * @return cloud_publish_switchbot_fake.return_val
 */
static int capture_switchbot(const bt_addr_le_t *addr, const struct switchbot_sample *sample)
{
    ARG_UNUSED(addr);
    published_sample = *sample;

    return cloud_publish_switchbot_fake.return_val;
}

/**
 * 各テストの前にモックを初期状態に戻す
 *
 * @param[in] fixture 使用しない
 */
static void before(void *fixture)
{
    ARG_UNUSED(fixture);
    RESET_FAKE(ble_init);
    RESET_FAKE(ble_scan);
    RESET_FAKE(ble_set_temperature_callback);
    RESET_FAKE(ble_set_switchbot_callback);
    RESET_FAKE(ble_set_time_source);
    RESET_FAKE(ntp_unix_time);
    RESET_FAKE(switchbot_accept);
    RESET_FAKE(cloud_publish_switchbot);
    RESET_FAKE(cloud_init);
    switchbot_accept_fake.custom_fake = fake_accept;
    cloud_publish_switchbot_fake.custom_fake = capture_switchbot;
    (void)memset(&published_sample, 0, sizeof(published_sample));
    RESET_FAKE(cloud_publish_temperature);
    FFF_RESET_HISTORY();
}

/** BLE の初期化に失敗したら, スキャンには進まず EXIT_FAILURE を返す */
ZTEST(main_gateway, test_ble_init_failure)
{
    ble_init_fake.return_val = -EIO;

    /* 期待: BLE の初期化に失敗したら, クラウドの初期化にもスキャンにも進まない */
    zassert_equal(thermo_gateway_main(), EXIT_FAILURE);
    zassert_equal(ble_init_fake.call_count, 1U);
    zassert_equal(ble_scan_fake.call_count, 0U);
    zassert_equal(ble_set_temperature_callback_fake.call_count, 0U);
}

/** クラウドの初期化に失敗したら, コールバックの設定とスキャンには進まず, EXIT_FAILURE を返す */
ZTEST(main_gateway, test_cloud_init_failure)
{
    cloud_init_fake.return_val = -EIO;

    /* 期待: クラウドの初期化の失敗で止まる (コールバックはまだ設定しない) */
    zassert_equal(thermo_gateway_main(), EXIT_FAILURE);
    zassert_equal(ble_init_fake.call_count, 1U);
    zassert_equal(cloud_init_fake.call_count, 1U);
    zassert_equal(ble_set_temperature_callback_fake.call_count, 0U);
    zassert_equal(ble_scan_fake.call_count, 0U);
}

/** スキャンの開始に失敗したら, EXIT_FAILURE を返す */
ZTEST(main_gateway, test_scan_failure)
{
    ble_scan_fake.return_val = -EALREADY;

    /* 期待: スキャンの開始の失敗で, EXIT_FAILURE (コールバックは設定済み) */
    zassert_equal(thermo_gateway_main(), EXIT_FAILURE);
    zassert_equal(ble_init_fake.call_count, 1U);
    zassert_equal(ble_scan_fake.call_count, 1U);
    zassert_equal(ble_set_temperature_callback_fake.call_count, 1U);
}

/** 初期化に成功したら, 初期化とスキャン開始を 1 回ずつ行い, 終了せずに動き続ける */
ZTEST(main_gateway, test_main_loop)
{
    k_thread_create(&main_thread, main_stack, K_THREAD_STACK_SIZEOF(main_stack), main_entry, NULL,
                    NULL, NULL, THREAD_PRIORITY, 0, K_NO_WAIT);

    k_msleep(STARTUP_WAIT_MS);
    zassert_equal(ble_init_fake.call_count, 1U);
    zassert_equal(ble_scan_fake.call_count, 1U);

    /*
     * 温度のコールバックはスキャンを始める前に設定する.
     * 呼び出しの順序: ble_init, cloud_init (コールバックが呼ばれる前に送信の準備をする),
     * set (温度), set (時刻), set (SwitchBot), scan
     */
    zassert_equal(ble_set_temperature_callback_fake.call_count, 1U);
    zassert_not_null(ble_set_temperature_callback_fake.arg0_val);
    zassert_equal(cloud_init_fake.call_count, 1U);
    zassert_equal(fff.call_history[0], FUNCTION_ADDRESS(ble_init));
    zassert_equal(fff.call_history[1], FUNCTION_ADDRESS(cloud_init));
    zassert_equal(fff.call_history[2], FUNCTION_ADDRESS(ble_set_temperature_callback));
    zassert_equal(fff.call_history[3], FUNCTION_ADDRESS(ble_set_time_source));
    zassert_equal(fff.call_history[4], FUNCTION_ADDRESS(ble_set_switchbot_callback));
    zassert_equal(fff.call_history[5], FUNCTION_ADDRESS(ble_scan));
    zassert_equal(ble_set_switchbot_callback_fake.call_count, 1U);

    /* ノードに書き込む時刻は SNTP で同期したシステム時計 (ntp_unix_time) から得る */
    zassert_equal(ble_set_time_source_fake.call_count, 1U);
    zassert_equal(ble_set_time_source_fake.arg0_val, ntp_unix_time);

    /* 温度のコールバックはノードのアドレスと温度と湿度と気圧をクラウドの送信のキューに渡す */
    ble_set_temperature_callback_fake.arg0_val(&test_addr, TEST_TEMP_X10, TEST_HUMIDITY_X10,
                                               TEST_PRESSURE_X10);
    zassert_equal(cloud_publish_temperature_fake.call_count, 1U);
    zassert_equal(cloud_publish_temperature_fake.arg0_val, &test_addr);
    zassert_equal(cloud_publish_temperature_fake.arg1_val, TEST_TEMP_X10);
    zassert_equal(cloud_publish_temperature_fake.arg2_val, TEST_HUMIDITY_X10);
    zassert_equal(cloud_publish_temperature_fake.arg3_val, TEST_PRESSURE_X10);

    /*
     * キューに入れられなくても (満杯など), ログに出すだけで問題なく戻る. 湿度なし, 気圧なし,
     * 0 ℃ 以上
     */
    cloud_publish_temperature_fake.return_val = -ENOMSG;
    ble_set_temperature_callback_fake.arg0_val(&test_addr, 235, THERMO_HUMIDITY_NONE,
                                               THERMO_PRESSURE_NONE);
    zassert_equal(cloud_publish_temperature_fake.call_count, 2U);
    zassert_equal(cloud_publish_temperature_fake.arg2_val, THERMO_HUMIDITY_NONE);
    zassert_equal(cloud_publish_temperature_fake.arg3_val, THERMO_PRESSURE_NONE);

    /* 何周期か待っても終了せず (k_thread_join() が EBUSY を返す), 初期化を繰り返さない */
    k_sleep(K_SECONDS(STATUS_INTERVAL_S * WAIT_CYCLES));
    zassert_equal(k_thread_join(&main_thread, K_NO_WAIT), -EBUSY);
    zassert_equal(ble_init_fake.call_count, 1U);
    zassert_equal(ble_scan_fake.call_count, 1U);

    k_thread_abort(&main_thread);
}

/** SwitchBot のコールバックは間引きを通った値をクラウドの送信のキューに渡す */
ZTEST(main_gateway, test_switchbot_forwarded_to_cloud)
{
    /* 広告データ */
    const struct switchbot_ad ad = {.kind = SWITCHBOT_ENV, .temp_x10 = 235, .humidity = 55U};

    /* コールバックを取り出すため, スキャンの失敗で main() を終わらせる */
    ble_scan_fake.return_val = -EIO;
    zassert_equal(thermo_gateway_main(), EXIT_FAILURE);

    switchbot_accept_fake.return_val = true;
    accepted_temp_x10 = 235;
    ble_set_switchbot_callback_fake.arg0_val(&test_addr, &ad);

    /* 期待: 間引きの結果の値 (23.5 ℃, 55 %, 電池 87 %) をクラウドに渡す */
    zassert_equal(switchbot_accept_fake.call_count, 1U);
    zassert_equal(cloud_publish_switchbot_fake.call_count, 1U);
    zassert_equal(published_sample.temp_x10, 235);
    zassert_equal(published_sample.humidity, 55U);
    zassert_equal(published_sample.battery, 87);
}

/** 間引きで捨てられた値 (または機種と電池残量だけのデータ) はクラウドに渡さない */
ZTEST(main_gateway, test_switchbot_dropped_by_interval)
{
    const struct switchbot_ad ad = {.kind = SWITCHBOT_INFO}; /* 広告データ */

    ble_scan_fake.return_val = -EIO;
    zassert_equal(thermo_gateway_main(), EXIT_FAILURE);

    switchbot_accept_fake.return_val = false;
    ble_set_switchbot_callback_fake.arg0_val(&test_addr, &ad);

    zassert_equal(switchbot_accept_fake.call_count, 1U);
    zassert_equal(cloud_publish_switchbot_fake.call_count, 0U);
}

/** 0 ℃ 未満の値とクラウドに渡せなかった (キューが満杯) 場合もログに出すだけで, 問題なく戻る */
ZTEST(main_gateway, test_switchbot_negative_and_queue_full)
{
    const struct switchbot_ad ad = {.kind = SWITCHBOT_ENV}; /* 広告データ */

    ble_scan_fake.return_val = -EIO;
    zassert_equal(thermo_gateway_main(), EXIT_FAILURE);

    switchbot_accept_fake.return_val = true;
    accepted_temp_x10 = -53;
    cloud_publish_switchbot_fake.return_val = -ENOMSG;
    ble_set_switchbot_callback_fake.arg0_val(&test_addr, &ad);

    zassert_equal(published_sample.temp_x10, -53);
    zassert_equal(cloud_publish_switchbot_fake.call_count, 1U);
    accepted_temp_x10 = 235;
}

ZTEST_SUITE(main_gateway, NULL, NULL, before, NULL, NULL);
```
