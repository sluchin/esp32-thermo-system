## CMakeLists.txt
```
cmake_minimum_required(VERSION 3.20.0)

# デバッグログ (LOG_DBG と LOG_HEXDUMP_DBG) を有効にする. アプリのソースだけに, THERMO_LOG_LEVEL=4 (DBG) を付ける
# (Zephyr のモジュールは既定のレベルのまま. 全体を DBG にすると, ログの量が多すぎて動かなくなる).
# 例: west build -b xiao_esp32c3 app/thermo-gateway -- -DTHERMO_DEBUG_LOG=ON
option(THERMO_DEBUG_LOG "Enable the debug logs of the application" OFF)

# ZView (docs/zview.md) で, スレッドの CPU の使用率やヒープを見るための設定 (app/zview.conf) を足す.
# メモリと CPU を少し余分に使うので, 通常のビルドには入れない. native_sim では使わない.
# 例: west build -b xiao_esp32c3 app/thermo-gateway -- -DTHERMO_ZVIEW=ON
option(THERMO_ZVIEW "Add the Kconfig options for ZView" OFF)
if(THERMO_ZVIEW AND NOT BOARD MATCHES "^native_sim")
  list(APPEND EXTRA_CONF_FILE ${CMAKE_CURRENT_LIST_DIR}/../zview.conf)
endif()

find_package(Zephyr REQUIRED HINTS $ENV{ZEPHYR_BASE})

project(thermo-gateway)
# strnlen は POSIX の関数. native_sim (glibc, -std=c99) ではこの定義がないと宣言が見えない
target_compile_definitions(app PRIVATE _POSIX_C_SOURCE=200809L)

target_sources(app PRIVATE src/main.c)
target_sources(app PRIVATE src/ble.c)
target_sources(app PRIVATE src/switchbot.c)

# AWS IoT Core への送信 (WiFi + MQTT). ネットワークのないビルド (native_sim) では含めない
# (thermo-node と共有する, app/common/ のソース)
target_sources_ifdef(CONFIG_THERMO_CLOUD app PRIVATE
  ${CMAKE_CURRENT_SOURCE_DIR}/../common/cfg.c
  ${CMAKE_CURRENT_SOURCE_DIR}/../common/cfg_shell.c
  ${CMAKE_CURRENT_SOURCE_DIR}/../common/cloud.c
  ${CMAKE_CURRENT_SOURCE_DIR}/../common/ntp.c
  ${CMAKE_CURRENT_SOURCE_DIR}/../common/payload.c
  ${CMAKE_CURRENT_SOURCE_DIR}/../common/wifi_link.c)

# thermo-node と thermo-gateway で共有する, BLE の UUID の定義 (app/common/)
target_include_directories(app PRIVATE ${CMAKE_CURRENT_SOURCE_DIR}/../common)
if(THERMO_DEBUG_LOG)
  target_compile_definitions(app PRIVATE THERMO_LOG_LEVEL=4)
endif()

# 警告オプション (app/warnings.txt). 警告が出たら修正する
include(${CMAKE_CURRENT_SOURCE_DIR}/../warnings.cmake)
include(${CMAKE_CURRENT_SOURCE_DIR}/../version.cmake)
```

## Kconfig
```
mainmenu "Thermo application"

config SIMULATOR
    bool "Build in simulator mode"
    help
      Use simulated sensor data and log simulator mode at startup.

config THERMO_CLOUD
    bool "Send temperatures to AWS IoT Core over WiFi and MQTT"
    default y
    help
      Connect to WiFi and publish the temperatures received from the nodes
      to AWS IoT Core with MQTT over TLS. The settings (WiFi, endpoint,
      certificates) are entered with the "thermo" shell command.
      Disable it for builds without a network (native_sim).

config THERMO_SWITCHBOT_INTERVAL_MS
    int "Minimum interval between two reports of one SwitchBot device [ms]"
    default 1000
    help
      The SwitchBot Outdoor Meter broadcasts its temperature in every
      advertisement. A reading of one device is reported at most once
      in this interval.

config THERMO_NTP_SERVER
    string "NTP server host name"
    default "pool.ntp.org"
    help
      The gateway sets its clock from this server with SNTP after the
      WiFi connection is up.

config THERMO_NTP_RESYNC_SEC
    int "Minimum interval between two time synchronizations [s]"
    default 3600
    help
      After a successful synchronization, the next one is skipped until
      this many seconds have passed (it is tried at each WiFi connection).

source "Kconfig.zephyr"
```

## prj.conf
```kconfig
# MCUboot ブートローダは使用しない
# CONFIG_BOOTLOADER_MCUBOOT is not set

# Bluetooth
CONFIG_BT=y
# デバイス名
CONFIG_BT_DEVICE_NAME="Thermo-Gateway"
CONFIG_BT_DEVICE_APPEARANCE=833
# セントラルロール (ノードをスキャンして接続する)
CONFIG_BT_CENTRAL=y
# オブザーバロール (アドバタイズをスキャンする)
CONFIG_BT_OBSERVER=y
# GATT クライアント (ノードのサービスを探索して, 温度の通知を購読する)
CONFIG_BT_GATT_CLIENT=y
# 同時に接続できるノードの数 (ESP32_BT_CTLR_LE_MAX_CONN の既定値 3 まで. 台数の考え方は TODO.md)
CONFIG_BT_MAX_CONN=3

# ログ
CONFIG_LOG=y
# ログを即時出力する (デバッグ向け)
CONFIG_LOG_MODE_IMMEDIATE=y

# コンソール
CONFIG_CONSOLE=y
CONFIG_UART_CONSOLE=y

# シェル (デバッグ用)
CONFIG_SHELL=y
CONFIG_SHELL_BACKEND_SERIAL=y

# --- AWS IoT Core への送信 (CONFIG_THERMO_CLOUD. WiFi + MQTT over TLS) ---
# ネットワーク (IPv4 と DHCP のみ)
CONFIG_NETWORKING=y
CONFIG_NET_IPV4=y
CONFIG_NET_IPV6=n
CONFIG_NET_DHCPV4=y
CONFIG_NET_TCP=y
CONFIG_NET_SOCKETS=y
CONFIG_DNS_RESOLVER=y
# SNTP (時刻の同期)
CONFIG_SNTP=y
# WiFi (ステーションモード)
CONFIG_WIFI=y
CONFIG_NET_L2_WIFI_MGMT=y
CONFIG_NET_MGMT_EVENT_QUEUE_SIZE=16
# MQTT と TLS (クライアント証明書による相互認証)
CONFIG_MQTT_LIB=y
CONFIG_MQTT_LIB_TLS=y
CONFIG_NET_SOCKETS_SOCKOPT_TLS=y
CONFIG_TLS_CREDENTIALS=y
CONFIG_MBEDTLS=y
CONFIG_MBEDTLS_BUILTIN=y
CONFIG_MBEDTLS_ENABLE_HEAP=y
CONFIG_MBEDTLS_HEAP_SIZE=40000
CONFIG_MBEDTLS_SSL_MAX_CONTENT_LEN=6144
# AWS IoT Core が使う暗号方式 (ECDHE-RSA + AES-GCM. 曲線は P-256)
CONFIG_MBEDTLS_ECDH_C=y
CONFIG_MBEDTLS_ECP_C=y
CONFIG_MBEDTLS_ECP_DP_SECP256R1_ENABLED=y
# RSA 署名 (サーバ証明書の確認, クライアント認証) と SHA-256
CONFIG_PSA_WANT_ALG_RSA_PKCS1V15_SIGN=y
CONFIG_PSA_WANT_ALG_RSA_PKCS1V15_CRYPT=y
CONFIG_PSA_WANT_ALG_SHA_256=y
# TLS 1.2 の鍵の導出 (PRF)
CONFIG_PSA_WANT_ALG_HMAC=y
CONFIG_PSA_WANT_ALG_TLS12_PRF=y
CONFIG_PSA_WANT_KEY_TYPE_HMAC=y
CONFIG_PSA_WANT_KEY_TYPE_DERIVE=y
CONFIG_PSA_WANT_ALG_ECDH=y
CONFIG_PSA_WANT_KEY_TYPE_ECC_KEY_PAIR_GENERATE=y
CONFIG_PSA_WANT_KEY_TYPE_ECC_KEY_PAIR_IMPORT=y
CONFIG_PSA_WANT_KEY_TYPE_ECC_KEY_PAIR_EXPORT=y
CONFIG_PSA_WANT_KEY_TYPE_ECC_KEY_PAIR_DERIVE=y
CONFIG_PSA_WANT_ECC_SECP_R1_256=y
CONFIG_PSA_WANT_ALG_GCM=y
CONFIG_MBEDTLS_KEY_EXCHANGE_ECDHE_RSA_ENABLED=y
CONFIG_MBEDTLS_CIPHER_GCM_ENABLED=y
# PEM 形式の証明書と秘密鍵 (cred add で登録するもの) を読む
CONFIG_MBEDTLS_PEM_CERTIFICATE_FORMAT=y
# TCP の接続と TLS のハンドシェイクの時間制限 [ms] (既定の 3000 では RSA の計算が間に合わない)
CONFIG_NET_SOCKETS_CONNECT_TIMEOUT=30000
# サーバ証明書の有効期限をシステム時計 (SNTP で同期. ntp.c) で確認する
CONFIG_MBEDTLS_HAVE_TIME_DATE=y
# 証明書の登録のための, シェルのコマンド (cred add など)
CONFIG_BASE64=y
CONFIG_TLS_CREDENTIALS_SHELL=y
# cred のバッファ [byte] (PEM 1 つぶん. 既定の 1024 では秘密鍵 (約 1.7 KB) が入らない)
CONFIG_TLS_CREDENTIALS_SHELL_CRED_BUF_SIZE=2048
# cred add のための, ヒープ (証明書 3 つぶん: 約 4.5 KB)
CONFIG_HEAP_MEM_POOL_ADD_SIZE_TLS_CRED_SHELL=5000
# 設定と証明書をフラッシュ (storage_partition) に保存する
CONFIG_SETTINGS=y
CONFIG_FLASH=y
CONFIG_FLASH_MAP=y
CONFIG_NVS=y
CONFIG_SETTINGS_NVS=y
# SwitchBot の温湿度計の値を AWS IoT Core に送る間隔 [ms] (1 台あたり. 10 秒に 1 回)
CONFIG_THERMO_SWITCHBOT_INTERVAL_MS=10000
# メインスレッドのスタックサイズ [byte]
CONFIG_MAIN_STACK_SIZE=4096

# スレッドのスタックの大きさ [byte]. 実機で ZView と shell の kernel thread stacks で, 動かしたあとの最大の使用量を
# 測って決めた (docs/zview.md). BT RX WQ は 1200 のうち 1200 (100 %) を使っていたので広げる.
# ESP32 のタイマーのスレッド (esp_timer) と, Bluetooth のコントローラのスレッドは, 使用量が少ないので縮めて,
# 広げた分の RAM を作る (node は RAM の空きが 112 バイトしかなかった).
CONFIG_BT_RX_STACK_SIZE=2048
CONFIG_ESP32_TIMER_TASK_STACK_SIZE=2048
CONFIG_ESP32_BT_CONTROLLER_STACK_SIZE=3072
# システムのワークキュー (sysworkq) も 1024 のうち 1024 (100 %) を使っていた
CONFIG_SYSTEM_WORKQUEUE_STACK_SIZE=2048
```

## prj-native_sim.conf
```kconfig
# シミュレータモード
# アプリ独自の Kconfig: シミュレータ用ビルドを有効にする
CONFIG_SIMULATOR=y
# ネットワークのないビルドなので, AWS IoT Core への送信は無効にする
CONFIG_THERMO_CLOUD=n

# Bluetooth
CONFIG_BT=y
# デバイス名
CONFIG_BT_DEVICE_NAME="Thermo-Gateway-Sim"
CONFIG_BT_DEVICE_APPEARANCE=833
# セントラルロール (ノードをスキャンして接続する)
CONFIG_BT_CENTRAL=y
# オブザーバロール (アドバタイズをスキャンする)
CONFIG_BT_OBSERVER=y
# GATT クライアント (ノードのサービスを探索して, 温度の通知を購読する)
CONFIG_BT_GATT_CLIENT=y
# 同時に接続できるノードの数 (ESP32_BT_CTLR_LE_MAX_CONN の既定値 3 まで. 台数の考え方は TODO.md)
CONFIG_BT_MAX_CONN=3

# ログ
CONFIG_LOG=y
# ログを即時出力する (デバッグ向け)
CONFIG_LOG_MODE_IMMEDIATE=y

# コンソール
CONFIG_CONSOLE=y
CONFIG_UART_CONSOLE=y

# シェル (デバッグ用)
CONFIG_SHELL=y
CONFIG_SHELL_BACKEND_SERIAL=y

# メインスレッドのスタックサイズ [byte]
CONFIG_MAIN_STACK_SIZE=8192
```

## src/main.c
```c
/*
 * Copyright (c) 2026 Tetsuya Higashi
 *
 * SPDX-License-Identifier: GPL-3.0-or-later
 */

/**
 * @file
 * @brief thermo-gateway のエントリポイント
 */

#include <zephyr/kernel.h>
#include <zephyr/logging/log.h>
#include <stdbool.h> /* true */
#include <stdint.h>  /* int16_t uint16_t */
#include <stdlib.h>  /* EXIT_SUCCESS EXIT_FAILURE abs */

#include "ble.h"
#ifdef CONFIG_THERMO_CLOUD
#include "cloud.h"
#include "ntp.h"
#endif
#include "thermo_ble_uuid.h"
#include "thermo_log.h"
#include "thermo_version.h"

LOG_MODULE_REGISTER(thermo_gateway, THERMO_LOG_LEVEL);

/** 稼働状況をログ出力する間隔 [s] */
#define STATUS_INTERVAL_S 10

static void on_temperature(const bt_addr_le_t *addr, int16_t temp_x10, uint16_t humidity_x10,
                           uint16_t pressure_x10);
static void on_switchbot(const bt_addr_le_t *addr, const struct switchbot_ad *ad);

/**
 * @brief ゲートウェイのメイン関数
 *
 * BLE を初期化して, (CONFIG_THERMO_CLOUD が有効なら) AWS IoT Core への送信を開始して,
 * 周辺のノードのスキャンを開始する. 見つけたノードには接続して, 温度の通知を購読する.
 * CONFIG_THERMO_CLOUD が有効なときは SNTP で同期した時刻を接続したノードに書き込む. SwitchBot
 * の温湿度計には接続せず, アドバタイズの値を受け取る. その後は定期的に稼働状況を出力する.
 *
 * @retval EXIT_FAILURE 初期化またはスキャン開始に失敗した場合
 *                      (正常時はループから戻らない)
 */
int main(void)
{
    int ret = EXIT_SUCCESS; /* 戻り値 */

/* ビルド構成に応じて起動ログを切り替える */
#ifdef CONFIG_SIMULATOR
    LOG_INF("Thermo Gateway started (SIMULATOR MODE)");
#else
    LOG_INF("Thermo Gateway started on ESP32C3");
#endif
    LOG_INF("Version %s (git %s)", THERMO_VERSION, THERMO_GIT_HASH);

    /* BLE を初期化する */
    ret = ble_init();
    if (ret != EXIT_SUCCESS) {
        LOG_ERR("Failed to initialize BLE");
        return EXIT_FAILURE;
    }

#ifdef CONFIG_THERMO_CLOUD
    /* 設定を読み込んで AWS IoT Core への送信のスレッドを開始する */
    ret = cloud_init(true);
    if (ret != EXIT_SUCCESS) {
        LOG_ERR("Failed to initialize the cloud connection");
        return EXIT_FAILURE;
    }
#endif

    /* 温度を受信したら, ログに出力する (クラウドが有効なら, 送信のキューにも入れる) */
    ble_set_temperature_callback(on_temperature);

#ifdef CONFIG_THERMO_CLOUD
    /* SNTP で同期した時刻を接続したノードに書き込む (ノードの RTC を合わせる) */
    ble_set_time_source(ntp_unix_time);
#endif

    /* SwitchBot の温湿度計 (接続しない) の値も同じ流れで扱う */
    ble_set_switchbot_callback(on_switchbot);

    /* 周辺ノードのスキャンを開始する */
    ret = ble_scan();
    if (ret != EXIT_SUCCESS) {
        LOG_ERR("Failed to start BLE scan");
        return EXIT_FAILURE;
    }

    /* 受信処理はコールバック側で行うため, ここでは定期的に稼働状況を出力するだけ */
    while (true) {
        LOG_INF("Gateway scanning for nodes...");
        (void)k_sleep(K_SECONDS(STATUS_INTERVAL_S));
    }
}

/**
 * 温度と湿度と気圧を受信したときのコールバック (ログに出力して, AWS IoT Core への送信のキューに
 * 入れる)
 *
 * Bluetooth のスレッドから呼ばれる.
 *
 * @param[in] addr         値を送ったノードのアドレス
 * @param[in] temp_x10     温度 [℃ の 10 倍]
 * @param[in] humidity_x10 湿度 [% の 10 倍] (湿度がなければ THERMO_HUMIDITY_NONE)
 * @param[in] pressure_x10 気圧 [hPa の 10 倍] (気圧がなければ THERMO_PRESSURE_NONE)
 */
static void on_temperature(const bt_addr_le_t *addr, int16_t temp_x10, uint16_t humidity_x10,
                           uint16_t pressure_x10)
{
    char addr_str[BT_ADDR_LE_STR_LEN] = {0}; /* アドレスの文字列 */
    int temp = temp_x10;                     /* 温度 [℃ の 10 倍] */
    /* 0 ℃ 未満は整数部が 0 でも (-0.5 など) 符号を出すため, 符号を別に出力する */
    const char *sign = ((temp < 0) ? "-" : "");       /* 符号 */
    unsigned int magnitude = (unsigned int)abs(temp); /* 絶対値 */
#ifdef CONFIG_THERMO_CLOUD
    int ret = EXIT_SUCCESS; /* 戻り値 */
#endif

    (void)bt_addr_le_to_str(addr, addr_str, sizeof(addr_str));
    if (humidity_x10 == THERMO_HUMIDITY_NONE) {
        LOG_INF("Node %s: %s%u.%u C", addr_str, sign, magnitude / 10U, magnitude % 10U);
    } else {
        LOG_INF("Node %s: %s%u.%u C, humidity: %u.%u %%", addr_str, sign, magnitude / 10U,
                magnitude % 10U, humidity_x10 / 10U, humidity_x10 % 10U);
    }
    if (pressure_x10 != THERMO_PRESSURE_NONE) {
        LOG_INF("Node %s: pressure: %u.%u hPa", addr_str, pressure_x10 / 10U, pressure_x10 % 10U);
    }

#ifdef CONFIG_THERMO_CLOUD
    ret = cloud_publish_temperature(addr, temp_x10, humidity_x10, pressure_x10);
    if (ret != EXIT_SUCCESS) {
        LOG_WRN("The temperature was not queued for AWS IoT Core (err %d)", ret);
    }
#endif
}

/**
 * SwitchBot の温湿度計のアドバタイズを受信したときのコールバック
 * (間引いて, ログに出力して, AWS IoT Core への送信のキューに入れる)
 *
 * Bluetooth のスレッドから呼ばれる.
 *
 * @param[in] addr 機器のアドレス
 * @param[in] ad 解析した結果 (機種と電池残量, または温度と湿度)
 */
static void on_switchbot(const bt_addr_le_t *addr, const struct switchbot_ad *ad)
{
    char addr_str[BT_ADDR_LE_STR_LEN] = {0}; /* アドレスの文字列 */
    struct switchbot_sample sample = {0};    /* サンプル */
    int temp = 0;                            /* 温度 [℃ の 10 倍] */
    const char *sign = "";                   /* 温度の符号 ("-" か "") */
    unsigned int magnitude = 0U;             /* 温度の絶対値 [℃ の 10 倍] */
#ifdef CONFIG_THERMO_CLOUD
    int ret = EXIT_SUCCESS; /* 戻り値 */
#endif

    /* 送信の間隔 (CONFIG_THERMO_SWITCHBOT_INTERVAL_MS) より短い間の値は捨てる */
    if (!switchbot_accept(addr, ad, k_uptime_get_32(), &sample)) {
        return;
    }

    /* 0 ℃ 未満は整数部が 0 でも (-0.5 など) 符号を出すため, 符号と絶対値に分けて表示する */
    temp = sample.temp_x10;
    sign = ((temp < 0) ? "-" : "");
    magnitude = (unsigned int)abs(temp);

    (void)bt_addr_le_to_str(addr, addr_str, sizeof(addr_str));
    LOG_INF("SwitchBot %s: %s%u.%u C, %u %%, battery %d %%", addr_str, sign, magnitude / 10U,
            magnitude % 10U, sample.humidity, sample.battery);

#ifdef CONFIG_THERMO_CLOUD
    ret = cloud_publish_switchbot(addr, &sample);
    if (ret != EXIT_SUCCESS) {
        LOG_WRN("The SwitchBot value was not queued for AWS IoT Core (err %d)", ret);
    }
#endif
}
```

## src/ble.h
```c
/*
 * Copyright (c) 2026 Tetsuya Higashi
 *
 * SPDX-License-Identifier: GPL-3.0-or-later
 */

#ifndef THERMO_GATEWAY_BLE_H
#define THERMO_GATEWAY_BLE_H

/**
 * @file
 * @brief thermo-gateway の BLE 制御 (ノードのスキャンと接続, GATT での温度の受信と時刻の書き込み)
 */

#include <zephyr/bluetooth/addr.h>
#include <stdint.h> /* int16_t uint16_t int64_t */

#include "switchbot.h"

/**
 * @brief 温度を受信したときのコールバックの型
 *
 * Bluetooth のスレッドから呼ばれるので, 時間のかかる処理は書かないこと.
 *
 * @param[in] addr         温度を送ったノードのアドレス
 * @param[in] temp_x10     温度 [℃ の 10 倍]
 * @param[in] humidity_x10 湿度 [% の 10 倍] (湿度がなければ THERMO_HUMIDITY_NONE)
 * @param[in] pressure_x10 気圧 [hPa の 10 倍] (気圧がなければ THERMO_PRESSURE_NONE)
 */
typedef void (*ble_temperature_cb_t)(const bt_addr_le_t *addr, int16_t temp_x10,
                                     uint16_t humidity_x10, uint16_t pressure_x10);

/**
 * @brief SwitchBot 屋外用温湿度計のアドバタイズを受信したときのコールバックの型
 *
 * Bluetooth のスレッドから呼ばれるので, 時間のかかる処理は書かないこと.
 * サービスデータ (機種, 電池残量) と製造者データ (温度, 湿度) は別々に届くので,
 * どちらもこのコールバックに渡す (間引きは switchbot_accept() が行う).
 *
 * @param[in] addr 機器のアドレス
 * @param[in] ad   解析した結果
 */
typedef void (*ble_switchbot_cb_t)(const bt_addr_le_t *addr, const struct switchbot_ad *ad);

/**
 * @brief ノードに書き込む時刻を得る関数の型
 *
 * システムの時計が合っているとき (SNTP で同期したあと) だけ, 時刻を返す.
 *
 * @param[out] unix_s UTC の UNIX 時刻 [s] の格納先
 * @retval EXIT_SUCCESS 時刻を返した
 * @retval negative     時刻がわからない (まだ同期していない. 書き込みを見送る)
 */
typedef int (*ble_time_source_t)(int64_t *unix_s);

int ble_init(void);

void ble_set_temperature_callback(ble_temperature_cb_t cb);

void ble_set_switchbot_callback(ble_switchbot_cb_t cb);

void ble_set_time_source(ble_time_source_t source);

int ble_scan(void);

#endif /* THERMO_GATEWAY_BLE_H */
```

## src/cfg.c
```c
/*
 * Copyright (c) 2026 Tetsuya Higashi
 *
 * SPDX-License-Identifier: GPL-3.0-or-later
 */

/**
 * @file
 * @brief 実行時の設定 (WiFi, AWS IoT Core のエンドポイント, 証明書) の保存と読み出し
 */

#include <zephyr/logging/log.h>
#include <zephyr/settings/settings.h>
#include <errno.h>  /* ENOENT EINVAL */
#include <stdint.h> /* uint8_t */
#include <stdio.h>  /* snprintf */
#include <stdlib.h> /* EXIT_SUCCESS */
#include <string.h> /* strcmp strlen memcpy */

#include "cfg.h"
#include "thermo_log.h"

LOG_MODULE_REGISTER(thermo_cfg, THERMO_LOG_LEVEL);

/** settings のこのアプリの項目のルート ("thermo/ssid" のように使う) */
#define SETTINGS_ROOT      "thermo"
/** settings の項目の名前 ("thermo/client_id" など) の最大長 (NUL を含む) */
#define SETTINGS_NAME_SIZE 32U

/** 設定の項目ごとの名前と値の最大長 */
static const struct {
    const char *name; /**< 項目の名前 (settings の名前とシェルの引数に使う) */
    size_t max;       /**< 値の最大長 (NUL を除く) */
} key_infos[CFG_KEY_COUNT] = {
    [CFG_KEY_SSID] = {"ssid", CFG_SSID_MAX},
    [CFG_KEY_PSK] = {"psk", CFG_PSK_MAX},
    [CFG_KEY_ENDPOINT] = {"endpoint", CFG_ENDPOINT_MAX},
    [CFG_KEY_CLIENT_ID] = {"client_id", CFG_CLIENT_ID_MAX},
};

/**
 * フラッシュから読み込んだ, CA 証明書の保存先
 *
 * tls_credential_add() はデータをコピーせず, ポインタを保持するので登録している間は,
 * 領域を残しておく必要がある.
 */
static uint8_t ca_buf[CFG_CERT_MAX];
/** フラッシュから読み込んだ, クライアント証明書の保存先 */
static uint8_t cert_buf[CFG_CERT_MAX];
/** フラッシュから読み込んだ, 秘密鍵の保存先 */
static uint8_t key_buf[CFG_KEY_PEM_MAX];

/** 証明書の種類ごとの名前と TLS の認証情報の種類と保存先 */
static const struct {
    const char *name;              /**< 名前 (settings の名前とシェルの引数に使う) */
    enum tls_credential_type type; /**< TLS の認証情報の種類 */
    uint8_t *buf;                  /**< フラッシュから読み込んだ証明書の保存先 */
    size_t max;                    /**< 証明書の最大サイズ */
} cred_infos[CFG_CRED_COUNT] = {
    [CFG_CRED_CA] = {"ca", TLS_CREDENTIAL_CA_CERTIFICATE, ca_buf, sizeof(ca_buf)},
    [CFG_CRED_CERT] = {"cert", TLS_CREDENTIAL_PUBLIC_CERTIFICATE, cert_buf, sizeof(cert_buf)},
    [CFG_CRED_KEY] = {"key", TLS_CREDENTIAL_PRIVATE_KEY, key_buf, sizeof(key_buf)},
};

/** 設定の値 (NUL で終わる) */
static char values[CFG_KEY_COUNT][CFG_ENDPOINT_MAX + 1U];

/** 証明書をフラッシュに保存するときの一時的な領域 (最も大きい証明書が入る大きさ) */
static uint8_t save_buf[CFG_KEY_PEM_MAX];

static void settings_name(char *out, const char *name);
static void load_value(enum cfg_key key, size_t len, settings_read_cb read_cb, void *cb_arg);
static void load_credential(enum cfg_cred cred, size_t len, settings_read_cb read_cb, void *cb_arg);
static int settings_set_cb(const char *name, size_t len, settings_read_cb read_cb, void *cb_arg);

/**
 * @brief 項目の名前 ("ssid" など) から, 項目を探す
 *
 * @param[in] name 項目の名前
 * @return 項目 (enum cfg_key). ない場合は -ENOENT
 */
int cfg_key_from_name(const char *name)
{
    size_t i = 0U; /* ループ用の添字 */

    for (i = 0U; i < ARRAY_SIZE(key_infos); i++) {
        if (strcmp(name, key_infos[i].name) == 0) {
            return (int)i;
        }
    }

    return -ENOENT;
}

/**
 * @brief 項目の名前を返す
 *
 * @param[in] key 項目
 * @return 項目の名前 (NUL で終わる)
 */
const char *cfg_key_name(enum cfg_key key)
{
    return key_infos[key].name;
}

/**
 * @brief 項目の値を返す
 *
 * @param[in] key 項目
 * @return 値 (NUL で終わる. 未設定なら空の文字列)
 */
const char *cfg_get(enum cfg_key key)
{
    return values[key];
}

/**
 * @brief 項目の値を設定して, フラッシュに保存する
 *
 * @param[in] key   項目
 * @param[in] value 値 (空でもよい)
 * @retval EXIT_SUCCESS 成功
 * @retval -EINVAL      値が長すぎる
 * @retval negative     保存に失敗 (負の errno)
 */
int cfg_set(enum cfg_key key, const char *value)
{
    char name[SETTINGS_NAME_SIZE] = {0}; /* settings の名前 */
    size_t len = strlen(value);          /* 値の長さ [バイト] */
    int err = EXIT_SUCCESS;              /* エラーコード */

    if (len > key_infos[key].max) {
        return -EINVAL;
    }

    /* フラッシュに保存できたときだけ, RAM の値を更新する (NUL も保存する) */
    settings_name(name, key_infos[key].name);
    err = settings_save_one(name, value, len + 1U);
    if (err != 0) {
        return err;
    }

    (void)memcpy(values[key], value, len + 1U);

    return EXIT_SUCCESS;
}

/**
 * @brief 証明書の種類の名前 ("ca" など) から, 種類を探す
 *
 * @param[in] name 名前
 * @return 種類 (enum cfg_cred). ない場合は -ENOENT
 */
int cfg_cred_from_name(const char *name)
{
    size_t i = 0U; /* ループ用の添字 */

    for (i = 0U; i < ARRAY_SIZE(cred_infos); i++) {
        if (strcmp(name, cred_infos[i].name) == 0) {
            return (int)i;
        }
    }

    return -ENOENT;
}

/**
 * @brief 証明書の種類の名前を返す
 *
 * @param[in] cred 種類
 * @return 名前 (NUL で終わる)
 */
const char *cfg_cred_name(enum cfg_cred cred)
{
    return cred_infos[cred].name;
}

/**
 * @brief 証明書が TLS の認証情報に登録されているか調べる
 *
 * @param[in] cred 種類
 * @return 登録されていれば true
 */
bool cfg_has_cred(enum cfg_cred cred)
{
    uint8_t probe = 0U;         /* 存在確認用の 1 バイト */
    size_t len = sizeof(probe); /* 値の長さ [バイト] */

    /* 登録されていれば, 1 byte の領域には入らないので, -EFBIG になる */
    return tls_credential_get(CFG_TLS_SEC_TAG, cred_infos[cred].type, &probe, &len) != -ENOENT;
}

/**
 * @brief TLS の認証情報に登録された証明書をフラッシュに保存する
 *
 * 保存した証明書は次の起動から, cfg_init() が自動で登録する.
 *
 * @retval EXIT_SUCCESS 成功
 * @retval -ENOENT      登録されていない証明書がある
 * @retval negative     失敗 (負の errno)
 */
int cfg_save_credentials(void)
{
    char name[SETTINGS_NAME_SIZE] = {0}; /* settings の名前 */
    size_t len = 0U;                     /* 値の長さ [バイト] */
    size_t i = 0U;                       /* ループ用の添字 */
    int err = EXIT_SUCCESS;              /* エラーコード */

    for (i = 0U; i < ARRAY_SIZE(cred_infos); i++) {
        /* 登録されている証明書を一時的な領域に取り出して, フラッシュに保存する */
        len = sizeof(save_buf);
        err = tls_credential_get(CFG_TLS_SEC_TAG, cred_infos[i].type, save_buf, &len);
        if (err != 0) {
            LOG_ERR("Credential '%s' is not available (err %d)", cred_infos[i].name, err);
            return err;
        }

        settings_name(name, cred_infos[i].name);
        err = settings_save_one(name, save_buf, len);
        if (err != 0) {
            LOG_ERR("Saving credential '%s' failed (err %d)", cred_infos[i].name, err);
            return err;
        }
    }

    return EXIT_SUCCESS;
}

/**
 * @brief 接続に必要な設定が全て揃っているか調べる
 *
 * SSID, エンドポイント, クライアント ID が空でなく, 3 つの証明書が登録されていること.
 *
 * @return 揃っていれば true
 */
bool cfg_is_complete(void)
{
    size_t i = 0U; /* ループ用の添字 */

    /* PSK はオープンネットワークでは, 空 */
    if ((values[CFG_KEY_SSID][0] == '\0') || (values[CFG_KEY_ENDPOINT][0] == '\0') ||
        (values[CFG_KEY_CLIENT_ID][0] == '\0')) {
        return false;
    }

    for (i = 0U; i < ARRAY_SIZE(cred_infos); i++) {
        if (!cfg_has_cred((enum cfg_cred)i)) {
            return false;
        }
    }

    return true;
}

/**
 * @brief 設定と証明書を全て消す (フラッシュからも消す)
 *
 * @retval EXIT_SUCCESS 成功
 * @retval negative     失敗 (負の errno. 最初のエラーを返すが全ての項目の削除を試みる)
 */
int cfg_reset(void)
{
    char name[SETTINGS_NAME_SIZE] = {0}; /* settings の名前 */
    size_t i = 0U;                       /* ループ用の添字 */
    int first_err = EXIT_SUCCESS;        /* 最初のエラー */
    int err = EXIT_SUCCESS;              /* エラーコード */

    /* 失敗しても残りの項目の削除を続けて, 最初のエラーを返す */
    for (i = 0U; i < ARRAY_SIZE(key_infos); i++) {
        settings_name(name, key_infos[i].name);
        err = settings_delete(name);
        if ((err != 0) && (first_err == EXIT_SUCCESS)) {
            first_err = err;
        }
        values[i][0] = '\0';
    }

    for (i = 0U; i < ARRAY_SIZE(cred_infos); i++) {
        settings_name(name, cred_infos[i].name);
        err = settings_delete(name);
        if ((err != 0) && (first_err == EXIT_SUCCESS)) {
            first_err = err;
        }
        /* 登録されていなくても (-ENOENT), かまわない */
        (void)tls_credential_delete(CFG_TLS_SEC_TAG, cred_infos[i].type);
    }

    return first_err;
}

/** settings のこのアプリの項目のハンドラ */
static struct settings_handler handler = {.name = SETTINGS_ROOT, .h_set = settings_set_cb};

/**
 * @brief 設定をフラッシュから読み込む (証明書は TLS の認証情報に登録する)
 *
 * @retval EXIT_SUCCESS 成功 (保存された設定がなくても成功)
 * @retval negative     失敗 (負の errno)
 */
int cfg_init(void)
{
    int err = settings_subsys_init(); /* エラーコード */

    if (err != 0) {
        LOG_ERR("Settings init failed (err %d)", err);
        return err;
    }

    err = settings_register(&handler);
    if (err != 0) {
        LOG_ERR("Registering the settings handler failed (err %d)", err);
        return err;
    }

    err = settings_load_subtree(SETTINGS_ROOT);
    if (err != 0) {
        LOG_ERR("Loading the settings failed (err %d)", err);
        return err;
    }

    return EXIT_SUCCESS;
}

/**
 * settings の項目の名前 ("thermo/ssid" など) を作る
 *
 * @param[out] out  出力先 (SETTINGS_NAME_SIZE)
 * @param[in]  name 項目の名前 ("ssid" など)
 */
static void settings_name(char *out, const char *name)
{
    (void)snprintf(out, SETTINGS_NAME_SIZE, SETTINGS_ROOT "/%s", name);
}

/**
 * settings から読み込んだ設定の値を登録する
 *
 * @param[in] key     項目
 * @param[in] len     保存されている値の長さ (NUL を含む)
 * @param[in] read_cb 値を読むコールバック
 * @param[in] cb_arg  read_cb に渡す引数
 */
static void load_value(enum cfg_key key, size_t len, settings_read_cb read_cb, void *cb_arg)
{
    ssize_t read_len = 0; /* 読み込んだ長さ [バイト] */

    if ((len == 0U) || (len > (key_infos[key].max + 1U))) {
        LOG_WRN("Ignoring '%s' with an invalid length %zu", key_infos[key].name, len);
        return;
    }

    read_len = read_cb(cb_arg, values[key], len);
    if (read_len < 0) {
        LOG_WRN("Reading '%s' failed (err %d)", key_infos[key].name, (int)read_len);
        values[key][0] = '\0';
        return;
    }
    values[key][len - 1U] = '\0'; /* 保存した値には NUL が含まれるが, 念のため */
}

/**
 * settings から読み込んだ証明書を TLS の認証情報に登録する
 *
 * @param[in] cred    種類
 * @param[in] len     保存されている証明書の長さ
 * @param[in] read_cb 証明書を読むコールバック
 * @param[in] cb_arg  read_cb に渡す引数
 */
static void load_credential(enum cfg_cred cred, size_t len, settings_read_cb read_cb, void *cb_arg)
{
    ssize_t read_len = 0;   /* 読み込んだ長さ [バイト] */
    int err = EXIT_SUCCESS; /* エラーコード */

    if ((len == 0U) || (len > cred_infos[cred].max)) {
        LOG_WRN("Ignoring credential '%s' with an invalid length %zu", cred_infos[cred].name, len);
        return;
    }

    read_len = read_cb(cb_arg, cred_infos[cred].buf, len);
    if (read_len < 0) {
        LOG_WRN("Reading credential '%s' failed (err %d)", cred_infos[cred].name, (int)read_len);
        return;
    }

    /* 同じ種類が登録されていたら, 置き換える (登録されていなくてもかまわない) */
    (void)tls_credential_delete(CFG_TLS_SEC_TAG, cred_infos[cred].type);
    err = tls_credential_add(CFG_TLS_SEC_TAG, cred_infos[cred].type, cred_infos[cred].buf, len);
    if (err != 0) {
        LOG_WRN("Adding credential '%s' failed (err %d)", cred_infos[cred].name, err);
    }
}

/**
 * settings が保存された項目を読み込むときに呼ぶコールバック
 *
 * 読み込めない項目があってもほかの項目の読み込みを続けるため, 常に 0 を返す.
 *
 * @param[in] name   項目の名前 (SETTINGS_ROOT の下の名前. "ssid" など)
 * @param[in] len    保存されている値の長さ
 * @param[in] read_cb 値を読むコールバック
 * @param[in] cb_arg  read_cb に渡す引数
 * @return 0
 */
static int settings_set_cb(const char *name, size_t len, settings_read_cb read_cb, void *cb_arg)
{
    int key = cfg_key_from_name(name);   /* 設定項目の番号 */
    int cred = cfg_cred_from_name(name); /* 証明書の番号 */

    if (key >= 0) {
        load_value((enum cfg_key)key, len, read_cb, cb_arg);
    } else if (cred >= 0) {
        load_credential((enum cfg_cred)cred, len, read_cb, cb_arg);
    } else {
        LOG_WRN("Ignoring the unknown setting '%s'", name);
    }

    return 0;
}
```

## src/cfg.h
```c
/*
 * Copyright (c) 2026 Tetsuya Higashi
 *
 * SPDX-License-Identifier: GPL-3.0-or-later
 */

#ifndef THERMO_GATEWAY_CFG_H
#define THERMO_GATEWAY_CFG_H

/**
 * @file
 * @brief 実行時の設定 (WiFi, AWS IoT Core のエンドポイント, 証明書) の保存と読み出し
 *
 * 設定は Zephyr のシェル (`thermo` コマンド. cfg_shell.c) で入力して, フラッシュ (settings の
 * NVS) に保存する. TLS の証明書は Zephyr の `cred` コマンドで, いったん RAM に登録してから,
 * `thermo save-certs` で, フラッシュに保存する.
 */

#include <zephyr/net/tls_credentials.h>
#include <stdbool.h> /* bool */

/** TLS の証明書を登録する, セキュリティタグ (CA, クライアント証明書, 秘密鍵で共通) */
#define CFG_TLS_SEC_TAG 1

/** SSID の最大長 [byte] (NUL を除く) */
#define CFG_SSID_MAX      32U
/** WiFi のパスワードの最大長 [byte] (NUL を除く) */
#define CFG_PSK_MAX       64U
/** AWS IoT Core のエンドポイントの最大長 [byte] (NUL を除く) */
#define CFG_ENDPOINT_MAX  128U
/** クライアント ID の最大長 [byte] (NUL を除く) */
#define CFG_CLIENT_ID_MAX 64U
/** 証明書 (CA, クライアント証明書) 1 つの最大サイズ [byte] (PEM. NUL を含む) */
#define CFG_CERT_MAX      1536U
/** 秘密鍵の最大サイズ [byte] (PEM. NUL を含む. RSA 2048 bit の PEM は約 1700 byte) */
#define CFG_KEY_PEM_MAX   1792U

/** 設定の項目 */
enum cfg_key {
    CFG_KEY_SSID,      /**< WiFi の SSID */
    CFG_KEY_PSK,       /**< WiFi のパスワード (空なら, オープンネットワーク) */
    CFG_KEY_ENDPOINT,  /**< AWS IoT Core のエンドポイント */
    CFG_KEY_CLIENT_ID, /**< MQTT のクライアント ID (トピックにも使う) */
    CFG_KEY_COUNT,     /**< 項目の数 */
};

/** 証明書の種類 */
enum cfg_cred {
    CFG_CRED_CA,   /**< AWS のルート CA 証明書 (サーバの確認用) */
    CFG_CRED_CERT, /**< クライアント証明書 (デバイス証明書) */
    CFG_CRED_KEY,  /**< クライアントの秘密鍵 */
    CFG_CRED_COUNT /**< 種類の数 */
};

int cfg_init(void);

int cfg_key_from_name(const char *name);

const char *cfg_key_name(enum cfg_key key);

const char *cfg_get(enum cfg_key key);

int cfg_set(enum cfg_key key, const char *value);

int cfg_cred_from_name(const char *name);

const char *cfg_cred_name(enum cfg_cred cred);

bool cfg_has_cred(enum cfg_cred cred);

int cfg_save_credentials(void);

bool cfg_is_complete(void);

int cfg_reset(void);

#endif /* THERMO_GATEWAY_CFG_H */
```

## src/cfg_shell.c
```c
/*
 * Copyright (c) 2026 Tetsuya Higashi
 *
 * SPDX-License-Identifier: GPL-3.0-or-later
 */

/**
 * @file
 * @brief 設定を入力するためのシェルのコマンド (`thermo`)
 *
 * 使い方:
 * @code
 *   thermo set <ssid|psk|endpoint|client_id> <値>
 *   cred buf load               (Zephyr のコマンド. PEM を貼り付けて, Ctrl-C で終える)
 *   cred add 1 CA default strt  (Zephyr のコマンド. 証明書の登録. CA, CLIENT, PK の 3 つ)
 *   thermo save-certs
 *   thermo show
 *   thermo apply
 *   thermo reset
 * @endcode
 */

#include <zephyr/shell/shell.h>
#include <errno.h>  /* EINVAL */
#include <stdlib.h> /* EXIT_SUCCESS */

#include "cfg.h"
#include "cloud.h"

/**
 * `thermo set <項目> <値>`: 設定の値をフラッシュに保存する
 *
 * @param[in] sh   シェル
 * @param[in] argc 引数の数 (3)
 * @param[in] argv 引数 (argv[1] が項目の名前, argv[2] が値)
 * @return 0 (成功), 負の errno (失敗)
 */
static int cmd_set(const struct shell *sh, size_t argc, char **argv)
{
    int key = cfg_key_from_name(argv[1]); /* 設定項目の番号 */
    int err = EXIT_SUCCESS;               /* エラーコード */

    ARG_UNUSED(argc);

    if (key < 0) {
        shell_error(sh, "Unknown item '%s' (ssid, psk, endpoint, client_id)", argv[1]);
        return -EINVAL;
    }

    err = cfg_set((enum cfg_key)key, argv[2]);
    if (err != 0) {
        shell_error(sh, "Failed to set '%s' (err %d)", argv[1], err);
        return err;
    }
    shell_print(sh, "%s saved", argv[1]);

    return EXIT_SUCCESS;
}

/**
 * `thermo show`: 設定の状態を表示する (パスワードは表示しない)
 *
 * @param[in] sh   シェル
 * @param[in] argc 使用しない
 * @param[in] argv 使用しない
 * @return 0
 */
static int cmd_show(const struct shell *sh, size_t argc, char **argv)
{
    size_t i = 0U; /* ループ用の添字 */

    ARG_UNUSED(argc);
    ARG_UNUSED(argv);

    for (i = 0U; i < (size_t)CFG_KEY_COUNT; i++) {
        if ((enum cfg_key)i == CFG_KEY_PSK) {
            shell_print(sh, "%s: %s", cfg_key_name(CFG_KEY_PSK),
                        ((cfg_get(CFG_KEY_PSK)[0] == '\0') ? "(empty)" : "********"));
        } else {
            shell_print(sh, "%s: %s", cfg_key_name((enum cfg_key)i), cfg_get((enum cfg_key)i));
        }
    }
    for (i = 0U; i < (size_t)CFG_CRED_COUNT; i++) {
        shell_print(sh, "%s: %s", cfg_cred_name((enum cfg_cred)i),
                    (cfg_has_cred((enum cfg_cred)i) ? "registered" : "missing"));
    }
    shell_print(sh, "ready to connect: %s", (cfg_is_complete() ? "yes" : "no"));

    return EXIT_SUCCESS;
}

/**
 * `thermo save-certs`: 登録した証明書をフラッシュに保存する
 *
 * @param[in] sh   シェル
 * @param[in] argc 使用しない
 * @param[in] argv 使用しない
 * @return 0 (成功), 負の errno (失敗)
 */
static int cmd_save_certs(const struct shell *sh, size_t argc, char **argv)
{
    int err = cfg_save_credentials(); /* エラーコード */

    ARG_UNUSED(argc);
    ARG_UNUSED(argv);

    if (err != 0) {
        shell_error(sh,
                    "Failed to save the certificates (err %d). Register ca, cert and key "
                    "with the 'cred add' command (security tag %d) first.",
                    err, CFG_TLS_SEC_TAG);
        return err;
    }
    shell_print(sh, "certificates saved");

    return EXIT_SUCCESS;
}

/**
 * `thermo apply`: 設定を反映する (接続をやり直す)
 *
 * @param[in] sh   シェル
 * @param[in] argc 使用しない
 * @param[in] argv 使用しない
 * @return 0
 */
static int cmd_apply(const struct shell *sh, size_t argc, char **argv)
{
    ARG_UNUSED(argc);
    ARG_UNUSED(argv);

    cloud_reconnect();
    shell_print(sh, "reconnecting");

    return EXIT_SUCCESS;
}

/**
 * `thermo reset`: 設定と証明書を全て消す
 *
 * @param[in] sh   シェル
 * @param[in] argc 使用しない
 * @param[in] argv 使用しない
 * @return 0 (成功), 負の errno (失敗)
 */
static int cmd_reset(const struct shell *sh, size_t argc, char **argv)
{
    int err = cfg_reset(); /* エラーコード */

    ARG_UNUSED(argc);
    ARG_UNUSED(argv);

    if (err != 0) {
        shell_error(sh, "Failed to erase the settings (err %d)", err);
        return err;
    }
    shell_print(sh, "settings erased");

    return EXIT_SUCCESS;
}

/** `thermo` コマンドのサブコマンド (set, show, save-certs, apply, reset) */
SHELL_STATIC_SUBCMD_SET_CREATE(
        thermo_cmds,
        SHELL_CMD_ARG(set, NULL, "<ssid|psk|endpoint|client_id> <value> : save a setting", cmd_set,
                      3, 0),
        SHELL_CMD(show, NULL, "show the settings (the password is hidden)", cmd_show),
        /*
         * コマンド名のハイフンは, clang-format が前後に空白を入れて ("save - certs"),
         * 別の名前にしてしまうので整形しない
         */
        /* clang-format off */
        SHELL_CMD(save-certs, NULL, "save the certificates added with 'cred add'", cmd_save_certs),
        /* clang-format on */
        SHELL_CMD(apply, NULL, "reconnect with the current settings", cmd_apply),
        SHELL_CMD(reset, NULL, "erase all the settings and certificates", cmd_reset),
        SHELL_SUBCMD_SET_END);

SHELL_CMD_REGISTER(thermo, &thermo_cmds, "Thermo gateway settings", NULL);
```

## src/cloud.c
```c
/*
 * Copyright (c) 2026 Tetsuya Higashi
 *
 * SPDX-License-Identifier: GPL-3.0-or-later
 */

/**
 * @file
 * @brief AWS IoT Core への MQTT (TLS) による温度の送信
 */

#include <zephyr/kernel.h>
#include <zephyr/logging/log.h>
#include <zephyr/net/mqtt.h>
#include <zephyr/net/socket.h>
#include <zephyr/net/tls_credentials.h>
#include <errno.h>   /* EHOSTUNREACH errno ECONNRESET ECONNREFUSED ENOSPC EAGAIN etc... */
#include <stdbool.h> /* bool true false */
#include <stdint.h>  /* uint32_t uint16_t uint8_t int64_t UINT16_MAX */
#include <stdlib.h>  /* EXIT_SUCCESS */
#include <string.h>  /* memcpy strlen */

#include "cfg.h"
#include "cloud.h"
#include "ntp.h"
#include "payload.h"
#include "wifi_link.h"
#include "thermo_log.h"

LOG_MODULE_REGISTER(thermo_cloud, THERMO_LOG_LEVEL);

/** AWS IoT Core の MQTT (TLS, クライアント証明書による相互認証) のポート */
#define BROKER_PORT        "8883"
/** MQTT の keep alive の間隔 [s] (AWS IoT Core は 30 .. 1200) */
#define KEEPALIVE_S        60U
/** 設定が揃うのを待つ間隔 [s] */
#define WAIT_CONFIG_S      5
/** WiFi の接続を待つ時間 [s] */
#define WIFI_TIMEOUT_S     30
/** NTP の応答を待つ時間 [ms] */
#define NTP_TIMEOUT_MS     5000
/** MQTT の CONNACK を待つ時間 [ms] */
#define CONNACK_TIMEOUT_MS 10000
/** 送信するものがないときに受信と keep alive を確認する間隔 [ms] */
#define SESSION_TICK_MS    1000
/** 接続の再試行の間隔の最小値 [s] */
#define RETRY_MIN_S        5U
/** 接続の再試行の間隔の最大値 [s] */
#define RETRY_MAX_S        60U
/** 送信を待つ温度の最大数 */
#define QUEUE_LEN          16
/** トピックのバッファのサイズ */
#define TOPIC_SIZE         128U
/** ペイロードのバッファのサイズ */
#define PAYLOAD_SIZE       160U
/*
 * ペイロードの最大長が入ること (SwitchBot の機器のアドレス, -3276.7 ℃, 湿度 100 %,
 * 電池 100 %, 稼働時間が最大で UNIX 時刻が 19 桁の場合は, 155 文字 + NUL)
 */
BUILD_ASSERT(PAYLOAD_SIZE >= 156U, "The payload buffer is too small");
/** MQTT の送受信バッファのサイズ */
#define MQTT_BUF_SIZE     512U
/** スレッドのスタックサイズ (TLS のハンドシェイクを含む) */
#define THREAD_STACK_SIZE 6144
/** スレッドの優先度 */
#define THREAD_PRIORITY   7

/** 送信を待つ値の種類 */
enum sample_kind {
    SAMPLE_THERMO,   /**< Thermo ノードの温度と湿度 */
    SAMPLE_SWITCHBOT /**< SwitchBot の温湿度計の値 */
};

/** 送信を待つ値 1 件 */
struct sample {
    enum sample_kind kind;             /**< 値の種類 */
    bt_addr_le_t addr;                 /**< 送ってきた機器のアドレス */
    uint32_t uptime_ms;                /**< 受信したときのゲートウェイの稼働時間 [ms] */
    int16_t temp_x10;                  /**< 温度 [℃ の 10 倍] (SAMPLE_THERMO のとき) */
    uint16_t humidity_x10;             /**< 湿度 [% の 10 倍] (SAMPLE_THERMO のとき) */
    struct switchbot_sample switchbot; /**< SwitchBot の値 (SAMPLE_SWITCHBOT のとき) */
};

/** 送信を待つ温度のキュー */
K_MSGQ_DEFINE(cloud_sample_q, sizeof(struct sample), QUEUE_LEN, 4);

/** MQTT クライアント */
static struct mqtt_client client;
/** ブローカーのアドレス (DNS で解決した結果) */
static struct sockaddr_storage broker;
/** MQTT の受信バッファ */
static uint8_t rx_buf[MQTT_BUF_SIZE];
/** MQTT の送信バッファ */
static uint8_t tx_buf[MQTT_BUF_SIZE];
/** TLS の証明書のセキュリティタグ */
static const sec_tag_t sec_tags[] = {CFG_TLS_SEC_TAG};

/** MQTT で接続している状態か (CONNACK を受け取ってから, DISCONNECT を受け取るまで) */
static volatile bool mqtt_up;
/** 設定が変わったので接続をやり直す依頼があるか */
static volatile bool reconnect_requested;
/** 次に失敗したときの再試行までの間隔 [s] */
static unsigned int retry_s = RETRY_MIN_S;
/** 次に publish するメッセージの ID (1 .. 65535) */
static uint16_t message_id;

/** 送信のスレッド */
static struct k_thread cloud_thread;
/** 送信のスレッドのスタック */
static K_THREAD_STACK_DEFINE(cloud_stack, THREAD_STACK_SIZE)

static void mqtt_evt_handler(struct mqtt_client *c, const struct mqtt_evt *evt);
static int resolve_broker(const char *host);
static int poll_input(int timeout_ms);
static int connect_broker(void);
static int64_t received_unix_time(uint32_t uptime_ms);
static int publish_sample(const struct sample *s);
static int run_session(void);
static void cloud_thread_entry(void *p1, void *p2, void *p3);
static int enqueue_sample(const struct sample *s);

/**
 * @brief 接続と送信を 1 回分だけ行う (スレッドが繰り返し呼ぶ)
 *
 * 設定が揃うまで待ち, WiFi と MQTT に接続して, 接続が切れるまでキューの温度を publish する.
 * 接続に失敗したときは間隔をあけてから (待つ時間は失敗のたびに倍にする), 戻る.
 *
 * @retval EXIT_SUCCESS 接続して, 設定の変更 (cloud_reconnect()) で正常に終わった
 * @retval -EAGAIN      設定が揃っていない
 * @retval negative     接続の失敗, または接続が切れた理由 (負の errno)
 */
int cloud_step(void)
{
    int err = EXIT_SUCCESS; /* エラーコード */

    /* 設定 (WiFi, エンドポイント, 証明書) が揃うまで接続しないで待つ */
    if (!cfg_is_complete()) {
        (void)k_sleep(K_SECONDS(WAIT_CONFIG_S));
        return -EAGAIN;
    }

    /* 接続をやり直す依頼はこれから始める接続で, 反映される */
    reconnect_requested = false;
    err = wifi_link_connect(cfg_get(CFG_KEY_SSID), cfg_get(CFG_KEY_PSK), K_SECONDS(WIFI_TIMEOUT_S));
    if (err == 0) {
        /*
         * サーバ証明書の有効期限を確認する (mbedTLS がシステム時計を使う) ので, 時計が合って
         * いないと, TLS の接続は必ず失敗する. 1 度も同期していなければ, 接続しないでやり直す.
         * 同期したことがあれば, 今回の同期に失敗しても時計は進んでいるので, 接続を続ける.
         */
        if (ntp_sync(CONFIG_THERMO_NTP_SERVER, K_MSEC(NTP_TIMEOUT_MS)) != 0) {
            LOG_WRN("Time synchronization failed");
        }
        if (ntp_is_synced()) {
            err = connect_broker();
        } else {
            err = -ETIME;
        }
    }
    /* 失敗したら, 間隔をあけてから, やり直す (間隔は失敗のたびに倍にして, 上限で止める) */
    if (err != 0) {
        LOG_WRN("Connection failed (err %d), retrying in %u s", err, retry_s);
        (void)k_sleep(K_SECONDS(retry_s));
        retry_s = MIN(retry_s * 2U, RETRY_MAX_S);
        return err;
    }

    retry_s = RETRY_MIN_S;
    LOG_INF("Connected to AWS IoT Core");
    err = run_session();
    if (err != 0) {
        (void)k_sleep(K_SECONDS(RETRY_MIN_S)); /* すぐに失敗を繰り返さない */
    }

    return err;
}

/**
 * @brief 設定を読み込んで, WiFi と MQTT のスレッドを開始する
 *
 * @retval EXIT_SUCCESS 成功
 * @retval negative     失敗 (負の errno)
 */
int cloud_init(void)
{
    int err = cfg_init(); /* エラーコード */

    if (err != 0) {
        return err;
    }

    err = wifi_link_init();
    if (err != 0) {
        return err;
    }

    (void)k_thread_create(&cloud_thread, cloud_stack, K_THREAD_STACK_SIZEOF(cloud_stack),
                          cloud_thread_entry, NULL, NULL, NULL, THREAD_PRIORITY, 0, K_NO_WAIT);
    (void)k_thread_name_set(&cloud_thread, "cloud");

    return EXIT_SUCCESS;
}

/**
 * @brief WiFi と MQTT のスレッドを止める (MQTT は切断しない)
 *
 * 通常は呼ばない (ゲートウェイは電源を切るまで動く). 単体テストがスレッドを残さないために使う.
 */
void cloud_stop(void)
{
    k_thread_abort(&cloud_thread);
}

/**
 * @brief 温度と湿度を送信のキューに入れる (待たずにすぐ戻る)
 *
 * Bluetooth のスレッドから呼べる. キューが満杯のときは, 新しい値を捨てる.
 *
 * @param[in] addr         温度を送ったノードのアドレス
 * @param[in] temp_x10     温度 [℃ の 10 倍]
 * @param[in] humidity_x10 湿度 [% の 10 倍] (湿度がなければ THERMO_HUMIDITY_NONE)
 * @retval EXIT_SUCCESS 成功
 * @retval -ENOMSG      キューが満杯で, 値を捨てた
 */
int cloud_publish_temperature(const bt_addr_le_t *addr, int16_t temp_x10, uint16_t humidity_x10)
{
    struct sample s = {.kind = SAMPLE_THERMO,
                       .addr = *addr,
                       .temp_x10 = temp_x10,
                       .humidity_x10 = humidity_x10,
                       .uptime_ms = k_uptime_get_32()}; /* キューに入れる, ノードの温度の値 */

    return enqueue_sample(&s);
}

/**
 * @brief SwitchBot の温湿度計の値を送信のキューに入れる (待たずにすぐ戻る)
 *
 * トピックは `thermo/<クライアント ID>/switchbot/<機器のアドレス>`. Bluetooth のスレッドから
 * 呼べる. キューが満杯のときは, 新しい値を捨てる.
 *
 * @param[in] addr   機器のアドレス
 * @param[in] sample 温度, 湿度, 電池残量
 * @retval EXIT_SUCCESS 成功
 * @retval -ENOMSG      キューが満杯で, 値を捨てた
 */
int cloud_publish_switchbot(const bt_addr_le_t *addr, const struct switchbot_sample *sample)
{
    struct sample s = {.kind = SAMPLE_SWITCHBOT,
                       .addr = *addr,
                       .switchbot = *sample,
                       .uptime_ms = k_uptime_get_32()}; /* キューに入れる, SwitchBot の値 */

    return enqueue_sample(&s);
}

/**
 * @brief 設定を変えたあとに, 接続をやり直させる
 *
 * 今の MQTT の接続を閉じて, 新しい設定でつなぎ直す.
 */
void cloud_reconnect(void)
{
    reconnect_requested = true;
    wifi_link_disconnect();
}

/**
 * MQTT のイベントのコールバック
 *
 * @param[in] c   MQTT クライアント (使用しない)
 * @param[in] evt イベント
 */
static void mqtt_evt_handler(struct mqtt_client *c, const struct mqtt_evt *evt)
{
    ARG_UNUSED(c);

    /* 使うのはこの 3 つだけ (購読はしない) */
    if (evt->type == MQTT_EVT_CONNACK) {
        if (evt->result == 0) {
            mqtt_up = true;
        } else {
            LOG_ERR("MQTT connection refused (result %d)", evt->result);
        }
    } else if (evt->type == MQTT_EVT_DISCONNECT) {
        LOG_WRN("MQTT disconnected");
        mqtt_up = false;
    } else if (evt->type == MQTT_EVT_PUBACK) {
        LOG_DBG("Publish acknowledged (id %u)", evt->param.puback.message_id);
    } else {
        LOG_DBG("Ignoring the MQTT event %d", (int)evt->type);
    }
}

/**
 * ブローカー (AWS IoT Core のエンドポイント) の名前を解決する
 *
 * @param[in] host エンドポイント
 * @retval EXIT_SUCCESS 成功 (broker にアドレスを保存する)
 * @retval -EHOSTUNREACH 名前を解決できなかった
 */
static int resolve_broker(const char *host)
{
    /* 名前解決の条件 (TCP) */
    struct zsock_addrinfo hints = {.ai_family = AF_INET, .ai_socktype = SOCK_STREAM};
    struct zsock_addrinfo *res = NULL;                            /* 名前解決の結果 */
    int err = zsock_getaddrinfo(host, BROKER_PORT, &hints, &res); /* エラーコード */

    if (err != 0) {
        LOG_ERR("Resolving '%s' failed (err %d)", host, err);
        return -EHOSTUNREACH;
    }

    (void)memcpy(&broker, res->ai_addr, res->ai_addrlen);
    zsock_freeaddrinfo(res);

    return EXIT_SUCCESS;
}

/**
 * ソケットを待って, 受信したデータがあれば, MQTT の処理をする
 *
 * @param[in] timeout_ms 待つ時間 [ms] (0 なら, 待たない)
 * @retval EXIT_SUCCESS データがなかった, または処理した
 * @retval -ECONNRESET  ソケットにエラーがある
 * @retval negative     poll() または mqtt_input() の失敗 (負の errno)
 */
static int poll_input(int timeout_ms)
{
    /* ポーリングの対象 */
    struct zsock_pollfd fds = {.fd = client.transport.tls.sock, .events = ZSOCK_POLLIN};
    int ret = zsock_poll(&fds, 1, timeout_ms); /* 戻り値 */

    if (ret < 0) {
        return -errno;
    }
    /* 時間内に受信したデータがなかった */
    if (ret == 0) {
        return EXIT_SUCCESS;
    }
    /* 切断, エラー: mqtt_input() を呼ぶ前に検出する */
    if ((fds.revents & (ZSOCK_POLLERR | ZSOCK_POLLHUP | ZSOCK_POLLNVAL)) != 0) {
        return -ECONNRESET;
    }

    return mqtt_input(&client);
}

/**
 * MQTT のブローカーに接続して, CONNACK を待つ
 *
 * @retval EXIT_SUCCESS 接続した
 * @retval -ECONNREFUSED CONNACK が拒否, または時間内に来なかった
 * @retval negative     名前の解決, 接続, 受信の失敗 (負の errno)
 */
static int connect_broker(void)
{
    const char *endpoint = cfg_get(CFG_KEY_ENDPOINT);           /* ブローカーのホスト名 */
    const char *client_id = cfg_get(CFG_KEY_CLIENT_ID);         /* クライアント ID */
    struct mqtt_sec_config *tls = &client.transport.tls.config; /* TLS の設定 */
    int err = resolve_broker(endpoint);                         /* エラーコード */

    if (err != 0) {
        return err;
    }

    /* MQTT クライアントを設定から作り直す (切断のたびに初期化する) */
    mqtt_client_init(&client);
    client.broker = &broker;
    client.evt_cb = mqtt_evt_handler;
    client.client_id.utf8 = (const uint8_t *)client_id;
    client.client_id.size = (uint32_t)strlen(client_id);
    client.protocol_version = MQTT_VERSION_3_1_1;
    client.rx_buf = rx_buf;
    client.rx_buf_size = sizeof(rx_buf);
    client.tx_buf = tx_buf;
    client.tx_buf_size = sizeof(tx_buf);
    client.keepalive = KEEPALIVE_S;
    client.clean_session = 1U;

    /* サーバの証明書を確認して, クライアント証明書で認証される (相互認証) */
    client.transport.type = MQTT_TRANSPORT_SECURE;
    tls->peer_verify = TLS_PEER_VERIFY_REQUIRED;
    tls->cipher_list = NULL;
    tls->sec_tag_list = sec_tags;
    tls->sec_tag_count = ARRAY_SIZE(sec_tags);
    tls->hostname = endpoint;

    /* TCP の接続と TLS のハンドシェイクと MQTT の CONNECT の送信まで, ここで行う */
    mqtt_up = false;
    err = mqtt_connect(&client);
    if (err != 0) {
        LOG_ERR("MQTT connect failed (err %d)", err);
        return err;
    }

    /* CONNACK を受信して, MQTT のイベント (mqtt_evt_handler) で, mqtt_up が true になるのを確認する
     */
    err = poll_input(CONNACK_TIMEOUT_MS);
    if ((err != 0) || !mqtt_up) {
        LOG_ERR("MQTT CONNACK not received (err %d)", err);
        (void)mqtt_abort(&client);
        return ((err != 0) ? err : -ECONNREFUSED);
    }

    return EXIT_SUCCESS;
}

/**
 * 値を受信したときの UNIX 時刻を求める (今の UNIX 時刻から, 受信してからの経過を引く)
 *
 * 受信した時点では, 時計が合っていないことがあるので, publish するときに求める
 * (接続の前に必ず同期している).
 *
 * @param[in] uptime_ms 受信したときのゲートウェイの稼働時間 [ms]
 * @return UNIX 時刻 [s]. 時計が合っていなければ, -1
 */
static int64_t received_unix_time(uint32_t uptime_ms)
{
    int64_t now = 0; /* 現在の UNIX 時刻 [s] */
    /* 32 bit の稼働時間は, 約 49 日で戻るので符号なしの引き算で, 経過を求める */
    uint32_t elapsed_ms = k_uptime_get_32() - uptime_ms; /* 受信してからの経過時間 [ms] */

    if (ntp_unix_time(&now) != EXIT_SUCCESS) {
        return -1;
    }

    return now - (int64_t)(elapsed_ms / 1000U);
}

/**
 * 温度 1 件を MQTT で publish する (QoS 1)
 *
 * @param[in] s 温度
 * @retval EXIT_SUCCESS 成功
 * @retval negative     失敗 (負の errno)
 */
static int publish_sample(const struct sample *s)
{
    char topic[TOPIC_SIZE] = {0};                       /* トピック */
    char payload[PAYLOAD_SIZE] = {0};                   /* ペイロード */
    struct mqtt_publish_param param = {0};              /* パブリッシュのパラメータ */
    const char *client_id = cfg_get(CFG_KEY_CLIENT_ID); /* クライアント ID */
    int64_t unix_s = received_unix_time(s->uptime_ms);  /* UNIX 時刻 [s] */
    int topic_len = 0;                                  /* トピックの長さ [バイト] */
    int payload_len = 0;                                /* ペイロードの長さ [バイト] */

    /* 値の種類でトピックとペイロードの形式が違う */
    if (s->kind == SAMPLE_SWITCHBOT) {
        topic_len = payload_format_switchbot_topic(topic, sizeof(topic), client_id, &s->addr);
        payload_len = payload_format_switchbot(payload, sizeof(payload), &s->addr, &s->switchbot,
                                               s->uptime_ms, unix_s);
    } else {
        topic_len = payload_format_topic(topic, sizeof(topic), client_id, &s->addr);
        payload_len = payload_format_temperature(payload, sizeof(payload), &s->addr, s->temp_x10,
                                                 s->humidity_x10, s->uptime_ms, unix_s);
    }

    /* ペイロードは必ずバッファに入る. トピックは長いクライアント ID で, 入らないことがある */
    if (topic_len < 0) {
        return -ENOSPC;
    }

    /* メッセージ ID は 1 から 65535 を順に使う (QoS 1 では, 0 は使えない) */
    message_id = (uint16_t)((message_id % UINT16_MAX) + 1U);
    param.message.topic.qos = MQTT_QOS_1_AT_LEAST_ONCE;
    param.message.topic.topic.utf8 = (const uint8_t *)topic;
    param.message.topic.topic.size = (uint32_t)topic_len;
    param.message.payload.data = (uint8_t *)payload;
    param.message.payload.len = (uint32_t)payload_len;
    param.message_id = message_id;
    param.dup_flag = 0U;
    param.retain_flag = 0U;

    LOG_DBG("MQTT publish (id %u, QoS 1) to %s", message_id, topic);
    LOG_HEXDUMP_DBG(payload, (uint32_t)payload_len, "MQTT publish payload");

    return mqtt_publish(&client, &param);
}

/**
 * 接続している間, キューの温度を publish して, 受信と keep alive を処理する
 *
 * 接続が切れるか, エラーになるか, cloud_reconnect() が呼ばれたら, MQTT を閉じて戻る.
 *
 * @retval EXIT_SUCCESS cloud_reconnect() が呼ばれた
 * @retval negative     接続が切れた, またはエラー (負の errno)
 */
static int run_session(void)
{
    struct sample s = {.kind = SAMPLE_THERMO}; /* 受信したサンプル */
    int err = EXIT_SUCCESS;                    /* エラーコード */

    while (!reconnect_requested) {
        /* 送るものがあれば, すぐ送る. なければ, 最大 SESSION_TICK_MS 待って, 受信などの確認に進む
         */
        if (k_msgq_get(&cloud_sample_q, &s, K_MSEC(SESSION_TICK_MS)) == 0) {
            err = publish_sample(&s);
            if (err != 0) {
                LOG_ERR("Publish failed (err %d)", err);
                break;
            }
        }

        /* 受信 (PUBACK, サーバからの切断など) を処理する. 待たない */
        err = poll_input(0);
        if ((err == 0) && !mqtt_up) {
            err = -ECONNRESET;
        }
        if (err != 0) {
            LOG_ERR("MQTT connection lost (err %d)", err);
            break;
        }

        /* keep alive の時間が来ていなければ, -EAGAIN */
        err = mqtt_live(&client);
        if (err == -EAGAIN) {
            err = EXIT_SUCCESS;
        }
        if (err != 0) {
            LOG_ERR("MQTT keep alive failed (err %d)", err);
            break;
        }
    }

    /* サーバが切断していなければ, DISCONNECT を送ってから, ソケットを閉じる */
    if (mqtt_up) {
        (void)mqtt_disconnect(&client, NULL);
    }
    (void)mqtt_abort(&client);
    mqtt_up = false;

    return err;
}

/**
 * 送信のスレッドの入口 (cloud_step() を繰り返す)
 *
 * @param[in] p1 使用しない
 * @param[in] p2 使用しない
 * @param[in] p3 使用しない
 */
static void cloud_thread_entry(void *p1, void *p2, void *p3)
{
    ARG_UNUSED(p1);
    ARG_UNUSED(p2);
    ARG_UNUSED(p3);

    while (true) {
        (void)cloud_step();
    }
}

/**
 * 値を送信のキューに入れる (待たない)
 *
 * @param[in] s 値
 * @retval EXIT_SUCCESS 成功
 * @retval -ENOMSG      キューが満杯で, 値を捨てた
 */
static int enqueue_sample(const struct sample *s)
{
    if (k_msgq_put(&cloud_sample_q, s, K_NO_WAIT) != 0) {
        LOG_WRN("Send queue is full, the value was dropped");
        return -ENOMSG;
    }

    return EXIT_SUCCESS;
}
```
