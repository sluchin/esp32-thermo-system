## CMakeLists.txt
```
# app/common の payload.c の単体テスト (Ztest + FFF).
cmake_minimum_required(VERSION 3.20.0)

find_package(Zephyr REQUIRED HINTS $ENV{ZEPHYR_BASE})
project(thermo_common_payload_test)

target_include_directories(app PRIVATE ${CMAKE_CURRENT_LIST_DIR}/../..)
target_sources(app PRIVATE
  src/test_payload.c
  ${CMAKE_CURRENT_LIST_DIR}/../../payload.c
)

# 警告オプション (app/warnings.txt). 警告が出たら修正する
include(${CMAKE_CURRENT_LIST_DIR}/../../../warnings.cmake)
# モック (FFF の FAKE_VALUE_FUNC) はヘッダにある関数を同じ型で再宣言する
target_compile_options(app PRIVATE -Wno-redundant-decls)
```

## prj.conf
```kconfig
# Ztest
CONFIG_ZTEST=y
CONFIG_LOG=y
```

## src/test_payload.c
```c
/*
 * Copyright (c) 2026 Tetsuya Higashi
 *
 * SPDX-License-Identifier: GPL-3.0-or-later
 */

/**
 * @file
 * @brief payload.c の単体テスト
 *
 * トピックと JSON のペイロードの形式とバッファが小さいときの -ENOSPC を確認する.
 */

#include <zephyr/ztest.h>
#include <errno.h>  /* ENOSPC */
#include <stdint.h> /* INT16_MAX INT16_MIN UINT32_MAX INT64_MAX */
#include <string.h> /* strlen strstr */

#include "payload.h"
#include "thermo_ble_uuid.h"

/** テストのノードのアドレス (表示は 00:AA:01:00:00:42. val[0] が下位の byte) */
static const bt_addr_le_t node = {
    .type = BT_ADDR_LE_PUBLIC,
    .a = {.val = {0x42, 0x00, 0x00, 0x01, 0xAA, 0x00}},
};

/** 期待するトピック */
#define EXPECTED_TOPIC    "thermo/gateway-01/00:AA:01:00:00:42/temperature"
/** 期待する SwitchBot のトピック */
#define EXPECTED_SB_TOPIC "thermo/gateway-01/switchbot/00:AA:01:00:00:42"
/** 期待する SwitchBot のペイロードの前半 (温度の前まで) */
#define SB_PAYLOAD_HEAD "{\"node\":\"00:AA:01:00:00:42\",\"type\":\"switchbot\",\"temperature_c\":"
/** 期待するペイロードの前半 (稼働時間の前まで. 23.5 ℃, 45.0 %) */
#define EXPECTED_PAYLOAD_HEAD                                                                      \
    "{\"node\":\"00:AA:01:00:00:42\",\"type\":\"thermo\",\"temperature_c\":23.5,"                  \
    "\"humidity\":45.0,"
/** 期待するペイロード */
#define EXPECTED_PAYLOAD EXPECTED_PAYLOAD_HEAD "\"uptime_ms\":123456}"

/** トピックはクライアント ID とノードのアドレスから作る */
ZTEST(payload, test_topic)
{
    char buf[64] = {0}; /* 出力バッファ */
    int len = payload_format_topic(buf, sizeof(buf), "gateway-01",
                                   &node); /* 書き込んだ長さ [バイト] */

    /* 期待: thermo/<クライアント ID>/<アドレス>/temperature の形式で長さは NUL を除く */
    zassert_equal(len, (int)strlen(EXPECTED_TOPIC));
    zassert_str_equal(buf, EXPECTED_TOPIC);
}

/** バッファがちょうどの大きさ (文字列 + NUL) ならトピックを作れる */
ZTEST(payload, test_topic_exact_size)
{
    char buf[sizeof(EXPECTED_TOPIC)] = {0}; /* 出力バッファ */

    /* 期待: バッファが文字列 + NUL でちょうどなら, 作れる */
    zassert_equal(payload_format_topic(buf, sizeof(buf), "gateway-01", &node),
                  (int)strlen(EXPECTED_TOPIC));
    zassert_str_equal(buf, EXPECTED_TOPIC);
}

/** バッファが 1 byte でも足りなければ, トピックは -ENOSPC */
ZTEST(payload, test_topic_no_space)
{
    char buf[sizeof(EXPECTED_TOPIC) - 1U] = {0}; /* 出力バッファ */

    /* 期待: 1 byte でも足りなければ, -ENOSPC */
    zassert_equal(payload_format_topic(buf, sizeof(buf), "gateway-01", &node), -ENOSPC);
}

/** ペイロードはアドレス, 温度, 湿度, 稼働時間の JSON (気圧がないときは気圧の項目はない) */
ZTEST(payload, test_payload)
{
    char buf[160] = {0}; /* 出力バッファ */
    /* 書き込んだ長さ [バイト] */
    int len = payload_format_temperature(buf, sizeof(buf), &node, 235, 450U, THERMO_PRESSURE_NONE,
                                         123456U, -1);

    /* 期待: アドレス, 種類, 温度 (23.5 ℃), 湿度 (45.0 %), 稼働時間を持つ JSON になる */
    zassert_equal(len, (int)strlen(EXPECTED_PAYLOAD));
    zassert_str_equal(buf, EXPECTED_PAYLOAD);
}

/** 0 ℃ 未満の温度には符号を付ける (-0.5 のように, 整数部が 0 でも) */
ZTEST(payload, test_payload_negative_temperature)
{
    char buf[160] = {0}; /* 出力バッファ */

    /* 期待: -3.5 ℃ は "-3.5", -0.5 ℃ は "-0.5", 0 ℃ は "0.0" */
    zassert_true(payload_format_temperature(buf, sizeof(buf), &node, -35, 450U,
                                            THERMO_PRESSURE_NONE, 1U, -1) > 0);
    zassert_not_null(strstr(buf, "\"temperature_c\":-3.5,"));
    zassert_true(payload_format_temperature(buf, sizeof(buf), &node, -5, 450U, THERMO_PRESSURE_NONE,
                                            1U, -1) > 0);
    zassert_not_null(strstr(buf, "\"temperature_c\":-0.5,"));
    zassert_true(payload_format_temperature(buf, sizeof(buf), &node, 0, 450U, THERMO_PRESSURE_NONE,
                                            1U, -1) > 0);
    zassert_not_null(strstr(buf, "\"temperature_c\":0.0,"));
}

/** 湿度がないとき (THERMO_HUMIDITY_NONE) は "humidity" を出力しない */
ZTEST(payload, test_payload_without_humidity)
{
    char buf[160] = {0}; /* 出力バッファ */

    /* 期待: 温度は出力して湿度の項目はない */
    zassert_true(payload_format_temperature(buf, sizeof(buf), &node, 235, THERMO_HUMIDITY_NONE,
                                            THERMO_PRESSURE_NONE, 123456U, -1) > 0);
    zassert_str_equal(buf, "{\"node\":\"00:AA:01:00:00:42\",\"type\":\"thermo\","
                           "\"temperature_c\":23.5,\"uptime_ms\":123456}");
}

/** 値が最大 (温度 3276.7, 湿度 6553.4, 気圧 6553.4, 稼働時間 4294967295) でもそのまま出力する */
ZTEST(payload, test_payload_max_values)
{
    char buf[176] = {0}; /* 出力バッファ (cloud.c の PAYLOAD_SIZE) */

    /* 期待: 最大の値でも桁を切らずに出力する */
    zassert_true(payload_format_temperature(buf, sizeof(buf), &node, INT16_MAX, 0xFFFEU, 0xFFFEU,
                                            UINT32_MAX, -1) > 0);
    zassert_not_null(strstr(buf, "\"temperature_c\":3276.7,"));
    zassert_not_null(strstr(buf, "\"humidity\":6553.4,"));
    zassert_not_null(strstr(buf, "\"pressure_hpa\":6553.4,"));
    zassert_not_null(strstr(buf, "\"uptime_ms\":4294967295}"));

    /* 最も長いペイロード (最小の温度と 19 桁の UNIX 時刻) は 163 文字 (PAYLOAD_SIZE に入る) */
    zassert_equal(payload_format_temperature(buf, sizeof(buf), &node, INT16_MIN, 0xFFFEU, 0xFFFEU,
                                             UINT32_MAX, INT64_MAX),
                  163);

    /* 温度が最小 (-3276.8) でも符号付きの絶対値で出力する */
    zassert_true(payload_format_temperature(buf, sizeof(buf), &node, INT16_MIN, 0U,
                                            THERMO_PRESSURE_NONE, 1U, -1) > 0);
    zassert_not_null(strstr(buf, "\"temperature_c\":-3276.8,"));
}

/** 気圧があれば, 湿度の次に "pressure_hpa" を出力する */
ZTEST(payload, test_payload_pressure)
{
    char buf[176] = {0}; /* 出力バッファ */

    /* 期待: 1013.2 hPa は 1013.2. 0.5 hPa のように, 1 hPa 未満も 0 を付けて出力する */
    zassert_true(payload_format_temperature(buf, sizeof(buf), &node, 235, 450U, 10132U, 123456U,
                                            -1) > 0);
    zassert_str_equal(buf, EXPECTED_PAYLOAD_HEAD "\"pressure_hpa\":1013.2,\"uptime_ms\":123456}");
    zassert_true(payload_format_temperature(buf, sizeof(buf), &node, 235, 450U, 5U, 1U, -1) > 0);
    zassert_not_null(strstr(buf, "\"pressure_hpa\":0.5,"));
}

/** 湿度がなくて気圧があるときは, 温度の次に "pressure_hpa" を出力する */
ZTEST(payload, test_payload_pressure_without_humidity)
{
    char buf[176] = {0}; /* 出力バッファ */

    /* 期待: 湿度の項目はなく, 気圧の項目はある */
    zassert_true(payload_format_temperature(buf, sizeof(buf), &node, 235, THERMO_HUMIDITY_NONE,
                                            10132U, 123456U, -1) > 0);
    zassert_str_equal(buf, "{\"node\":\"00:AA:01:00:00:42\",\"type\":\"thermo\","
                           "\"temperature_c\":23.5,\"pressure_hpa\":1013.2,\"uptime_ms\":123456}");
}

/** バッファが足りなければ, ペイロードは -ENOSPC (途中で切れた JSON を返さない) */
ZTEST(payload, test_payload_no_space)
{
    char buf[sizeof(EXPECTED_PAYLOAD) - 1U] = {0}; /* 出力バッファ */

    /* 期待: 足りなければ -ENOSPC (途中で切れた JSON を返さない) */
    zassert_equal(payload_format_temperature(buf, sizeof(buf), &node, 235, 450U,
                                             THERMO_PRESSURE_NONE, 123456U, -1),
                  -ENOSPC);
}

/** SwitchBot のトピックはクライアント ID と機器のアドレスから作る (switchbot の階層を挟む) */
ZTEST(payload, test_switchbot_topic)
{
    char buf[64] = {0}; /* 出力バッファ */
    /* 書き込んだ長さ [バイト] */
    int len = payload_format_switchbot_topic(buf, sizeof(buf), "gateway-01", &node);

    /* 期待: thermo/<クライアント ID>/switchbot/<アドレス> */
    zassert_equal(len, (int)strlen(EXPECTED_SB_TOPIC));
    zassert_str_equal(buf, EXPECTED_SB_TOPIC);
}

/** SwitchBot のトピック: ちょうどの大きさなら作れて, 1 byte 足りなければ -ENOSPC */
ZTEST(payload, test_switchbot_topic_size_limit)
{
    char exact[sizeof(EXPECTED_SB_TOPIC)] = {0};      /* ちょうどの大きさのバッファ */
    char small[sizeof(EXPECTED_SB_TOPIC) - 1U] = {0}; /* 1 バイト足りないバッファ */

    zassert_equal(payload_format_switchbot_topic(exact, sizeof(exact), "gateway-01", &node),
                  (int)strlen(EXPECTED_SB_TOPIC));
    zassert_equal(payload_format_switchbot_topic(small, sizeof(small), "gateway-01", &node),
                  -ENOSPC);
}

/** SwitchBot のペイロードは温度 (℃), 湿度, 電池残量, 稼働時間を持つ JSON */
ZTEST(payload, test_switchbot_payload)
{
    char buf[160] = {0}; /* 出力バッファ */
    /* サンプル */
    const struct switchbot_sample sample = {.temp_x10 = 235, .humidity = 55U, .battery = 87};

    zassert_true(payload_format_switchbot(buf, sizeof(buf), &node, &sample, 123456U, -1) > 0);

    /* 期待: 温度は小数点以下 1 桁 (23.5). 電池残量が湿度のあとに続く */
    zassert_str_equal(buf, SB_PAYLOAD_HEAD "23.5,\"humidity\":55,\"battery\":87,"
                                           "\"uptime_ms\":123456}");
}

/** 0 ℃ 未満の温度は符号を付ける (整数部が 0 の -0.5 でも符号を落とさない) */
ZTEST(payload, test_switchbot_payload_negative_temperature)
{
    char buf[160] = {0}; /* 出力バッファ */
    struct switchbot_sample sample = {
        .temp_x10 = -53, .humidity = 55U, .battery = 87}; /* サンプル */

    zassert_true(payload_format_switchbot(buf, sizeof(buf), &node, &sample, 1U, -1) > 0);
    zassert_not_null(strstr(buf, "\"temperature_c\":-5.3,"));

    sample.temp_x10 = -5;
    zassert_true(payload_format_switchbot(buf, sizeof(buf), &node, &sample, 1U, -1) > 0);
    zassert_not_null(strstr(buf, "\"temperature_c\":-0.5,"));
}

/** 0.0 ℃ は符号なし */
ZTEST(payload, test_switchbot_payload_zero_temperature)
{
    char buf[160] = {0}; /* 出力バッファ */
    const struct switchbot_sample sample = {
        .temp_x10 = 0, .humidity = 0U, .battery = 0}; /* サンプル */

    zassert_true(payload_format_switchbot(buf, sizeof(buf), &node, &sample, 1U, -1) > 0);
    zassert_not_null(strstr(buf, "\"temperature_c\":0.0,\"humidity\":0,\"battery\":0,"));
}

/** 電池残量がわからないときは battery の項目を出力しない */
ZTEST(payload, test_switchbot_payload_unknown_battery)
{
    char buf[160] = {0}; /* 出力バッファ */
    const struct switchbot_sample sample = {
        .temp_x10 = 235,
        .humidity = 55U,
        .battery = SWITCHBOT_BATTERY_UNKNOWN}; /* 電池残量が不明な SwitchBot の値 */

    zassert_true(payload_format_switchbot(buf, sizeof(buf), &node, &sample, 1U, -1) > 0);

    zassert_is_null(strstr(buf, "battery"));
    zassert_not_null(strstr(buf, "\"humidity\":55,\"uptime_ms\":1}"));
}

/** 最大の値 (-3276.7 ℃, 湿度 100 %, 電池 100 %, 稼働時間が最大) でも 123 文字で, 160 byte に収まる
 */
ZTEST(payload, test_switchbot_payload_longest)
{
    char buf[160] = {0}; /* 出力バッファ */
    const struct switchbot_sample sample = {
        .temp_x10 = INT16_MIN + 1,
        .humidity = 100U,
        .battery =
                100}; /* 出力が最も長くなる SwitchBot の値 (最小の温度, 湿度 100 %, 電池 100 %) */

    zassert_equal(payload_format_switchbot(buf, sizeof(buf), &node, &sample, UINT32_MAX, -1), 123);
}

/** バッファが足りなければ, SwitchBot のペイロードは -ENOSPC (途中で切れた JSON を返さない) */
ZTEST(payload, test_switchbot_payload_no_space)
{
    char buf[100] = {0}; /* 出力バッファ */
    /* サンプル */
    const struct switchbot_sample sample = {.temp_x10 = 235, .humidity = 55U, .battery = 87};

    zassert_equal(payload_format_switchbot(buf, sizeof(buf), &node, &sample, 123456U, -1), -ENOSPC);
}

/** UNIX 時刻があれば, "timestamp" を末尾に出力する */
ZTEST(payload, test_payload_timestamp)
{
    char buf[160] = {0}; /* 出力バッファ */

    zassert_true(payload_format_temperature(buf, sizeof(buf), &node, 235, 450U,
                                            THERMO_PRESSURE_NONE, 123456U, 1790000000) > 0);
    zassert_str_equal(buf, EXPECTED_PAYLOAD_HEAD "\"uptime_ms\":123456,\"timestamp\":1790000000}");
}

/** UNIX 時刻が 0 (1970 年) でも出力する (出力しないのは負のときだけ) */
ZTEST(payload, test_payload_timestamp_zero)
{
    char buf[160] = {0}; /* 出力バッファ */

    zassert_true(payload_format_temperature(buf, sizeof(buf), &node, 1, 1U, THERMO_PRESSURE_NONE,
                                            1U, 0) > 0);
    zassert_not_null(strstr(buf, "\"uptime_ms\":1,\"timestamp\":0}"));
}

/** SwitchBot のペイロードにも末尾に "timestamp" を出力する */
ZTEST(payload, test_switchbot_payload_timestamp)
{
    char buf[160] = {0}; /* 出力バッファ */
    /* サンプル */
    const struct switchbot_sample sample = {.temp_x10 = 235, .humidity = 55U, .battery = 87};

    zassert_true(payload_format_switchbot(buf, sizeof(buf), &node, &sample, 1U, 1790000000) > 0);
    zassert_not_null(strstr(buf, "\"uptime_ms\":1,\"timestamp\":1790000000}"));
}

/** 最大の値 (UNIX 時刻が 19 桁を含む) でも 155 文字で 160 byte に収まる */
ZTEST(payload, test_switchbot_payload_longest_with_timestamp)
{
    char buf[160] = {0}; /* 出力バッファ */
    const struct switchbot_sample sample = {
        .temp_x10 = INT16_MIN + 1,
        .humidity = 100U,
        .battery =
                100}; /* 出力が最も長くなる SwitchBot の値 (最小の温度, 湿度 100 %, 電池 100 %) */

    zassert_equal(payload_format_switchbot(buf, sizeof(buf), &node, &sample, UINT32_MAX, INT64_MAX),
                  155);
}

ZTEST_SUITE(payload, NULL, NULL, NULL, NULL, NULL);
```
